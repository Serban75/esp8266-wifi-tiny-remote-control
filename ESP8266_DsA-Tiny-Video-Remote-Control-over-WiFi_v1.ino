/************************************************************************************************* 
  Serban D. - ESP8266 - DsA Tiny Video Remote Control over WiFi v1.0 
  Features:   ESP8266 WiFi device host name, Date and Time, Temperature and Humidity, 
              Lights/LED Control, Video by IP Camera for Android Phones, 
              Servo control (servo can be used for Camera/Phone), 2x DC Motor control, 
              WiFi Manager, HTML5, Bootstrap, JavaScript, Ajax/Json, and other stuff... 
**************************************************************************************************/


#include <ESP8266WiFi.h>          //https://github.com/esp8266/Arduino

//#include <ESPAsyncTCP.h>         // ESPAsyncTCP - https://github.com/me-no-dev/ESPAsyncTCP

#include <ESPAsyncWebServer.h>     // ESPAsyncWebServer - https://travis-ci.org/me-no-dev/ESPAsyncWebServer
#include <ESPAsyncWiFiManager.h>   // ESPAsyncWiFiManager - https://travis-ci.org/tzapu/WiFiManager / https://github.com/tzapu/WiFiManager

#include <AsyncJson.h>             // included as dependency 
#include <ArduinoJson.h>           // ArduinoJson - https://www.ardu-badge.com/ArduinoJson/6.15.1
#include <Adafruit_Sensor.h>       // Adafruit_Unified_Sensor by Adafruit
#include <DHT.h>                   // DHT_sensor_library by Adafruit

//internal LED ticker
#include <Ticker.h>
Ticker ticker;

void tick()
{
  //toggle state
  int state = digitalRead(BUILTIN_LED);  // get the current state of GPIO1 pin
  digitalWrite(BUILTIN_LED, !state);     // set pin to the opposite state
}

// Declare sensor for humity and temperature
#define DHTPIN 5     // Pinout D1 (GPIO5) , Digital pin connected to the DHT sensor

// Uncomment the type of sensor in use:
#define DHTTYPE    DHT11     // DHT 11
//#define DHTTYPE    DHT22     // DHT 22 (AM2302)
//#define DHTTYPE    DHT21     // DHT 21 (AM2301)

DHT dht(DHTPIN, DHTTYPE);

// current temperature & humidity, updated in loop()
float t = 0.0;
float h = 0.0;

// Generally, you should use "unsigned long" for variables that hold time
// The value will quickly become too large for an int to store
unsigned long previousMillis = 0;    // will store last time DHT was updated

// Updates DHT readings every 10 seconds
const long interval = 10000; 

// Declare Light1, Light2, etc...
const int Light1 = D6; // digital pin connected to the LED1
const int Light2 = D7; // digital pin connected to the LED2
// const int LightN = Dn; // add more lights here, LEDn... Make sure you're selecting the right DIGITAL PIN (as above)

String resetwifi = "Off";

//gets called when WiFiManager enters configuration mode
void configModeCallback(AsyncWiFiManager *myWiFiManager) {
  Serial.println("Entered config mode");
  Serial.println(WiFi.softAPIP());
  //if you used auto generated SSID, print it
  Serial.println(myWiFiManager->getConfigPortalSSID());
  //entered config mode, make led toggle faster
  ticker.attach(0.2, tick);
}

AsyncWebServer server(80);
DNSServer dns;

const char index_html[] PROGMEM = R"rawliteral(
<!DOCTYPE html>
<html lang="en">
<head>
  <meta charset="utf-8">
  <meta name="viewport" content="width=device-width, initial-scale=1">
  <meta name="description" content="IoT">
  <meta name="author" content="DsA">

  <link rel="shortcut icon" href="data:image/x-icon;base64,iVBORw0KGgoAAAANSUhEUgAAAgAAAAIACAYAAAD0eNT6AAAABGdBTUEAALGPC/xhBQAAAAFzUkdCAK7OHOkAAAAgY0hSTQAAeiYAAICEAAD6AAAAgOgAAHUwAADqYAAAOpgAABdwnLpRPAAAAAlwSFlzAAASdAAAEnQB3mYfeAAAAAZiS0dEAP8A/wD/oL2nkwAAACV0RVh0ZGF0ZTpjcmVhdGUAMjAxOC0xMC0wM1QxMDozNjo0NSswMjowMPod6J0AAAAldEVYdGRhdGU6bW9kaWZ5ADIwMTgtMTAtMDNUMTA6MzY6NDUrMDI6MDCLQFAhAAAAGXRFWHRTb2Z0d2FyZQB3d3cuaW5rc2NhcGUub3Jnm+48GgAApHpJREFUeF7tnQm8TdUXxxcqMmeeZzJkSIkMUTSSiEopFEkj9W9QShOleR5kqBQpEaKSIVOmJpIiFJV5ykyT//tte3vn3nfvfffes88+0/r+P+d/ztn39dz9e+vstc7ea++d40gGFBD+++8/cditUo4cOcSRM2dOcWYiYZ3NwDqbgXU2A+tsBuirDkU8nXLKs+/RZVyAjSs+rLMZWGczsM5mYJ3NAH1j6RxP90D0AKDC//77rxbjgmHlypWLjSsGrLMZWGczsM5mYJ3NAJ2hsVXnaJ2y3Gf8sP2/ikvgq6PSquJ2gXGpg8mEdTYD62wG1tkMrLMZoK3SOhaJggDfBgCqwuqwAwRh44oN62wG1tkMrLMZWGczQGelNc4KaGYl3r0v1VQVRreSXeMCVgNjMmGdzcA6m4F1NgPrbAbojCOWzii3Eu/edz0A+Lq6jEsZFsaU2LgiYZ3NwDqbgXU2A+tsDqUxNLcC3RTWaxD9me9URYX/+ecf28YF2LjiwzqbgXU2A+tsBtbZDHD+8QIA6312n/mmBwBfU1Ua13a/NgzruOOOY+OKgnU2A+tsBtbZDKyzGaArnL7SOZp4b/9xrzN+ib2/lAHwFVFhRJY6vq4yLghhFSPssM5mYJ3NwDqbgXU2A7RVPSxWnaM1st4nuhZHxi+y/xdzEHw9GBeOWN0dqYAKK+PiyDIS1tkMrLMZWGczsM5miNYZWllJdB/rGvri2tMqq0oj4sHZrnGh0jAwNq5IWGczsM5mYJ3NwDqbQemMA85flVn1jnUfD2itDs8qjQoo41KVtgOMCpElDIzJhHU2A+tsBtbZDKyzGaw64xwNPs8O68+oQAtncZ/xYfa/wQVQ4b///luLccGw2LhiwzqbgXU2A+tsBtbZDNAZR7TOyoErrPfxrqGv1fkDzwUA+DqIdNi4nIV1NgPrbAbW2QyssxmsOuM6Htk5fnWG44fG1p8BnhoC0G1cqDCMC5VnMmGdzcA6m4F1NgPrbIZonXGvjmisZbE+B9AXWkc7f+CZHgB8DdXdgcrbARVFhY8//nhR+VgVDyussxlYZzOwzmZgnc0AnaFvoiArWi/rffQ19IXWOMfCEwGAU8aFM5MJ62wG1tkMrLMZWGczROsMreIR/Zn1Htc4snP+wPW+FzYuM7DOZmCdzcA6m4F1NkMsnVGGIxbxyhXJOH/gegCACqO7w65xATau+LDOZmCdzcA6m4F1NkMineMFAtYy63Wyzh+4FgDgC6PCOHQklCCZBMaVTKXDBOtsBtbZDKyzGVhnM6SiM342O+D4oXWyOrvy10BFVMSj27jQzcQchXU2A+tsBtbZDKyzGXTojN8BoGuqzh8YTwKMrrSdfx6VZuOKjVVnu913rHN8WGczsM5mYJ3NYNVZ+cFk9Yn+OWiLQ+mcCkYDAKeMi8eUImGdzcA6m4F1NgPrbIbsdIZ2ibB+jmvoC63T0dnYEAAblxlYZzOwzmZgnc3AOpshGZ3xMzjioT6DztAXWqers7EAQJdxATau+EDnv/76i3V2GNbZDKyzGVhnM+jUGfpCazs6Ox4AIFqB48ehI6EEhoUj1bGOoKN0hnElih6ThXWODetsBtbZDKyzGdLROdHPwfHbdf7A0RwA/GpEPKg4J/w5h9IZxmU3yGKd48M6m4F1NgPrbAY7OkfriHs4fV06OxamqUrD+aO7A/fpwsYVH6vO/BA7B+tsBtbZDKyzGezqjP9eAV11On/gSABgrbTdsQ5rpXFm48qEdTYD62wG1tkMrLMZ/KCz9gDAiUqfcMIJ4sxkwjqbgXU2A+tsBtbZDDp1BtBXOX+daA8AVKXtdisBdCuxccUGOmNMSYdxsc7xYZ3NwDqbgXU2g26dnXD+QFsAgIgHjl+X80eFcWCsg8lE6QzjYp2dg3U2A+tsBtbZDE7p7FSQpWUWAH4FIh5U3FrpdH41upVUxAPjwj1zFKWzDuNinePDOpuBdTYD62wGP+psO3xTlcaho9KIdNi4sgJtoXF0kJUOrHN8WGczsM5mYJ3NoFtnU0GWrQDA6vztjnUo41JjSmxcmUBn6AvjYp2dg3U2A+tsBtbZDLp1Vs7fhM5pBwCq0k44fyYT6KwiS9bZOVhnM7DOZmCdzaBbZ6vzN0HaAQAqi0rb7e4AqDQbV2xgXBhTsmtcgHWOD+tsBtbZDKyzGXTrbNL5g5QDAGvEo8P5o8JqrIPJBDpDYxgX6+wcrLMZWGczsM5mCIrOKc0CwI8i0kEAgEqr/zTer0j0q63dHag07pmjQDcVWdo1LtY5PqyzGVhnM7DOZgiSzkmHG6h0LOefDqgkujnYuLKijAvRpQ7jYp1jwzqbgXU2A+tshqDpnFQPAH4Ezl8dqkwR71fEKleV5jGlrEAvZVxK53RhnePDOpuBdTYD62yGIOqcbQ8AKo1IBxXWVWlEPGxckThhXKxzVlhnM7DOZmCdzRBUnbMNAOD8UXG73R0AlUXEgzEPJhJojDElu8YFWOf4sM5mYJ3NwDqbIag6JwwAUFlUHNGPXRDtoNIY62AygbaIKmFcOoIsGBXrnBXW2QyssxlYZzMEXeeY3wKVhvPHgWsc6YLuDlQaAQAqjXvmKNBVRZZ2jUvprIyLdc6EdTYD62wG1tkMYdA5SwCASqOycP46Kq26O9i4IlHGheiSdXYO1tkMrLMZWGczhEXniAAAlcaBCuNsB1QSEY9KdGDjysRqXHbHlJRxsc5ZYZ3NwDqbgXU2Q5h0zhIAoMJ2Ix6gKo0ggMnEKeNinSNhnc3AOpuBdTZD2HQ+FgDA6aPCEMAuqCwqjcozkcC4MKZk17gAdEa3Ej/EWWGdzcA6m4F1NkPYdBYBAJy/jm5/gMrC+WOsg8kE2iKqhHHp6GGBxqxzVlhnM7DOZmCdzRBWnXOisjgggB3Q3WF1/rhnjgJtVWRp17igq9W4WOdMWGczsM5mYJ3NEGadc6LyOOyASqqxDjauSJRxIbrUYVysc2xYZzOwzmZgnc0Qdp1FAGAHa6VxZuPKxGpcdseUlM4YU2KdI2GdzcA6m4F1NgPrbEkCTAdVaeX8mUycNC4mE9bZDKyzGVhnM7DOR7EVAKCyGPdn48oKjAtjSnaNC6hsUtY5K6yzGVhnM7DOZmCdj5J2AIBK42DjigSRJaJKGJfdMSWA3hU1psRkwjqbgXU2A+tsBtY5kpS/terugPNn44oExqUiS7vGBZ2txoV75iissxlYZzOwzmZgnbOSkgdHJVFZVBpBABtXJsq4EF3qMC7oyw9xVlhnM7DOZmCdzcA6xybpAEBVmt/8s2I1LrtjSkpnNabED3EmrLMZWGczsM5mYJ3jk5QnRyXh9HnMPytOGheTCetsBtbZDKyzGVjnxCQVACjnz2/+WYFxYUzJrnEBaMwPcWxYZzOwzmZgnc3AOicmW4+OyqLi7PwjQWSJqBLGZXdMCWA8SY0pMZmwzmZgnc3AOpuBdU6OhLWB88fBxhUJjEtFlnaNC91KVuPCPXMU1tkMrLMZWGczsM7JE9Ozo5KoLDv/rCjjQnSpw7igMT/EWWGdzcA6m4F1NgPrnBoxvTsqi4rjzGRiNS67Y0rKuNSYEj/EmbDOZmCdzcA6m4F1Tp0ID49Kwumrg8nESeNiMmGdzcA6m4F1NgPrnB5ZAgBUmJ1/VmBcGFOya1yAs3bjwzqbgXU2A+tsBtY5PY55ejh9VBhBAJMJIktElTAuu2NKAONJakyJyYR1NgPrbAbW2Qyssz1yZIh3BE4fFWbnHwmMS0WWdo0L2iKyVMbFWmfCOpuBdTYD62wG1tk+OVFRNqysKONCdKnDuNC7wg9xVlhnM7DOZmCdzcA66yFHhniiB4DJxGpcdseUlHHx2F1WWGczsM5mYJ3NwDrrQ/QAMJmwcZmBdTYD62wG1tkMrLNecmQIekReMxnAsHSMKQF0KeHghzgrQdcZ9du5c2eWY8+ePaLhwXijOvC9s7vGgToWL16cSpcuTXny5JH/UmLYns3AOpuBddYLBwASFVnqNi4eu4vEzzpv3ryZVq5cSWvXro3p3K3Hvn375H/lDIUKFRKBQKlSpY6do6+LFStGBQoUEJrbhe05NtxumIF1dgYOADLQaVwwJvW2xg9xJH7QGW8YcPBw9NHH7t275U/5B+hTokQJERDUrFmT6tSpI45TTjlF9CZkB9tzfLjdMAPr7ByhDwCUcaHh1zmmxMYVidd03rVrF61atSqLk4fzx/cMAwgMrAEBzggScufOLT5ne44PtxtmYJ2dJdQBgFPGhTOTiRd0hnOfO3cuzZs3Txzr16+XnzBW8HZUrVo1ERDgOPXUU+m0006jsmXLyp9guN0wA+vsPKENANi4zOCGzvh3li5deszhz58/n7Zt2yY/ZdKhevXq1Lp1a2rTpg2dffbZVKRIEflJuOB2wwyssxlCGwDAsHQnlLBxZcWEzocOHaIlS5YIZw+nv3DhQtq7d6/8lNENuk/RM6ACgubNm9OJJ54oPw023G6YgXU2Q+gCABVZ6jYuHlOKxEmd8bvh7KdNmybOX331FR0+fFj+JGMa5AyceeaZIhhAUNCoUaPANbbcbpiBdTYH9A1VAKDTuGBMnE0aGyd0hkP58ssv6cMPP6Tx48eLKXmMNylYsCC1atVKBATt2rWjypUry0/8CbcbZmCdzQCdcYQqAFDGpXtMiY0rEp0643ctXryYJk6cSBMmTGCn71OaNm1KV111FV1++eVJTT30EtxumIF1NgN0xqECrFAEAE4ZF85MJjp0hmFiDB9Of9KkSez0AwTeyM4991zq2rUrdejQgfLlyyc/8SbcbpiBdTYDdMaBNhZnaBX4AADVY+NyHjs6wyAXLVok3vInT57MTj8E5M2bly655BIRDJx33nmiq9ZLcLthBtbZHGhnlfMHoQgAYFi6E0rYuLKSjs4///wzjRgxgj766CN2+iGmaNGiYngAwQCGC9AwuQ23G2Zgnc2A4Eo5f/V8BToAQLUQWeo2Lh5TiiRVnfHz06dPp1dffZW++OKLY9Eow4CKFSuKfIHu3bvTySefLEvNwe2GGVhnc8D5W3tXAh8A6DQuiMTZpLFJRWdsjvPuu+/S0KFDxXK7DJMIPGeYQfC///2PWrZsKUudhdsNM7DOZoDO0BfOH9dKG+s5cAGAMi7dY0psXJEkqzOcPZw+nL/TO+QxweT000+nO++8kzp37uxY9y63G2Zgnc0Ana3OHyh9rOdABQBOGZdTjY5fyU5nfI7ufXTzo7s/QCbGuEilSpWoX79+1LNnT8qfP78stQ+3G2Zgnc0AnZXzx9nq8KPPgQkA2LjMkEjnAwcO0OjRo8UbPxL8GMYJChcuTDfccAPddtttVKZMGVmaHtxumIF1NgN0hr44cA2sDj/6HJgAAIalO6GEjSsrsXTevn07Pf/88/TWW2/Rnj17ZCnDOAueUSQMIk+gbt26sjQ1uN0wA+tsBgRZcP7Zvfmrs+8DAHx9VFq3cfGYUiSxdN6/fz+9+OKL9NJLL/H4PuMqWEsAeQJYaCgZuN0wA+tsBugMxw+tcQ2sjj7e2dcBgE7jghicTRqbaJ1xHjlyJD355JPi7Z/JBN2SmNderFixY4f1HhvnQE/oiLP1UF130Fp9jjM2OoLOW7duFQe2NsZ59+7d8l9lFFhH4JlnnqEmTZrIkqxAV243nId1NoNqO6A1rhVKo0Rn3wYAMChUWveYEhtXJFadcXzwwQc0aNAg+u233+RPhIeTTjqJatWqRbVr1xZz1EuWLJnF0WMjnHRIx57RsCIQsAYH1gABeRgrV64M5U6Jl112GT3++ONUtWpVWXIUbjfMwDqbwer8oTlQ+iRz9mUAgK+MCus2Lh5TisSq89SpU+nhhx+mFStWyE+DS+nSpYWjV85eneHwncBJe8bvW7NmDf3www8Rx+rVq23/W14HGtx00030wAMPUJEiRbjdMATrbAboDH2htXL+AJole/ZdAMDGZQal89y5c0UDig16gga6FBs2bEjNmzenOnXqHHP6yDI3hVv2jF4B9A5EBwbr1q2TPxEc8PccMGAA9enTR7xBcrvhHNw+m0HpjAPOH1op1HUyZ98FADAsHWNKQCWUsHFlZenSpaLR/OSTT2SJ/4HDx6IyWFkO+9U3a9aMChQoID91B6/Z86ZNm2jWrFk0c+ZMcV6/fr38xP9gmeEHH3yQOnXqdKwRTAduN+LD7bMZoLNy/sBqz7EcfbyzbwIAFfHoNi4eU4rkjz/+oHvvvZfGjBmjRWc3wd+3UaNGEQ7fK1vQ+sWesZKjCgiwuBNyC/zOaaedRoMHDxYJg6nC7UZsuH02g9IZAYDVdVs1UtfJnH0RAOg0LlSas0mzAo3feOMNuueee3ybXY6/JbK/zznnHOHw0cBj21mv4Vd7xvfGMAECAhxz5szx9UwE7DXwyCOPULVq1WRJfLjdiA+3z2ZQOkc7f2DVSV1ndxb6ZvwiTwcAMCiMJaHSOseU2LgywVter169aPbs2bLEP+BveOaZZ9IVV1wh1oq3uzKc0wTJnvH9v/nmG5o8ebLoMfr111/lJ/4BzgZDXVhMKB7cbsSH22czKOePQ+ls1SfWdaIz9BUaezkAUJXWbVw4M0cbcKzghyS/gwcPylLvg79l48aNxR7ymO5Vrlw5+Ym3Cbo9L1q0SAQCmCq6ZcsWWeoPbr31VjEsEA23G/Hh9tkMSmer8wfQTBHrOtZZHdBYXGf8ck8GAE4YF7qVEPEzJLpysanKkiVLZIn3wXg+3vTh9CtUqCBL/UGY7Bn1Q84AgoGPPvrIN8tDd+vWTaxsiTcjwO1GfLh9NoNV5+jhFeimiHUd6wzbVs5flGX8A54MAFBhXQklMCqOLI8CTR977DFxQGOvg4Qt9aZfuXJlWeo/wmrPhw4dEmtIIBjA2euLEr3yyit0zTXXiGtuN+LD7bMZoDOOWDorJw5iXUefoS+OiJ/1WgCgIh7dxsVjSiTe9vHWj7d/L4NMfbyNoVsW8/L9DNtzJkgYnDBhgggG0EPgxXcPrPCI5wRvo9xuZIXt2QxK53jOH0Q48hjX1jMcPzTGYcVTAYBO41KVZuM6uk0vxvkx3q/joXUK7Pd+yy23iCDF5GI8TsH2HB8sU6x2kPRa/sm4ceOoY8eO7JSiYHs2g9I5kfMHVs1iXeOMA/qqACAazwQA1krrGlNi4yIxd/v6668Xmf5eBVP2+vbtS+3bt49ppH6E7Tk5duzYQa+99proet+8ebMsdZeLLrqIpkyZEup2Ixq2ZzPE0jmePtbyWNc4Q+d4zh94IgBwwrjCnlACHe+//3564oknhL5eI0+ePNS1a1e67bbbqF69erI0GLA9pw5yAzA08Oyzz7o+RIW8k6+//lreMWzPZoins3Lo0VjLo69xwOlD40QvVa4HAGxc+sFucFdeeaUYZ/UamLKHDVp69+4tds8LGmzP9vn888/Flr44u0GNGjVo1apV8i7csD2bIZHO0C0W1vLoa+icnfMHrgcAqLDuhBJUPqwsXrxYLIiDJX29RM2aNcU67PhuQX742Z71sXz5ctEjgJ4BaGoKLCa1YcMGeRdu2J7NkEjnVAMA6IwjO+cPXBtwRdzhhHElU+mggrHUs846y1POH2/8w4cPF926Xbp0EX+nIML2rJ+6devSm2++KTYk6t+/v7FlnfPnzy+vwgvbsxmc0BlHsjq78tdApdHdoaPSiHzQpaSMK160FGSQRd29e3fRtQ5NvQD2X3/qqafEvvPI6g9y1M/27CylSpWixx9/XHTLY3qo007kqquuklfhhO3ZDDp1Bsr5p6Kx8SEAVWlEPbrGlMJsXMjux/amy5YtkyXugjn8/fr1o7vuuosKFSokS4ML27MZrDpjq2okuGKGi26g+Zo1a6hKlSqyJFywPZshFZ3j6abKlc4ItFINjo0GAE4ZF85hBFOVsGrZn3/+KUvcA8aH6YZYbwBvbGGA7dkM8XSePn26CAR++uknWWKfFi1a0Ny5c+VduGB7NkOqOitHHw3Klc54809HZ2NDAGxc+kB3ERwt5s277fzxt8CMAzTCmMvNzj91wm7PiUik87nnnksLFiwQ6/eXLFlSlqYPeqzwu8II27MZdOoMoG+6zh8Y6wFAhXWNdeBtE0cYjQsLp2CM0q0pUlbOP/98GjJkCDVo0ECWhAe2ZzMkq/P+/fvphRdeEEc6KwueeOKJNG3aNNEDEEbYns2Qjs4IqGIBje04f+B4AKAiHlQa13b/OWVcYRxTwjg/3vp/++03WeIOxYsXF29KyOoPG1Z71tlY8hhpJOnqvGnTJho0aBCNHj066f8O+mOPgnbt2smS8MD2bAY7OsfSERrbdf7A0QBAVRpRDypt55+CCKhwWI1r3rx5dPHFF4sNVdzk6quvFmu4B3ERn+yw8xBHE3Z7ToQOnVesWEFvvPGGcOzxnhlM98MMldtvv50qVqwoS8MD27MZ7Ops1RLXcPq6dHYsAFCVhvPXOaYURuNCsh+2xHVz05Ty5cvT0KFD6cILL5Ql4YLt2Qy6dcbvQdf+Rx99JBpfOP0CBQqIjaeuvfZaOumkk+RPhwu2ZzPo0FnpqXTWGWQ5EgA4ZVw4h4133nmHrrvuOqGnG0B/rC+AedhoOMMI27MZWGczsM5m0KUzNFY6w/nr1Fl7AMDGpQ90td9xxx1CUzfA3uhYxa958+ayJHywPZuBdTYD62wG3Tqr4RXdOmufBqgqbXdMCaDSYTUuzG/G2KQbzh+633fffSLpMMzOH8CeMXZn9yEGsewZf19ksGM3vDDjtM7MUVhnM+jW2QnnD7T1AFgjHuX87fxqVFjnWIdfgHbocsd4uxtgK9QRI0ZQ/fr1ZUk4UfacbOLO1q1bxaqMv/zyi7iGU9+7d684W499+/YdO9Tn6jnBg45hFjVOjbP12lpWsGBBqlChAlWvXp2qVatmbJ183aSqc3aEtd3IDtbZDE7p7FSQpSUAUJWOfvNP51dbuzvCZlwwGmTZjxs3TpaYAzqj1wE79oU9oo/3EG/fvl04eXXA2WPZWFzDobsF/nbYwU4FAziro2rVqmKOuxeJp3M6hLndyA7W2Qx+1Nl2AKAqjSO6uyPVX41KwvmgWylsxgUHcumll4rlTU2DTOh3332XLrroIlkSXvDg4gH+6quvxNTL77777pjD37Nnj/wp/4BnCDsyIhhATkezZs3EjpGY1eEm0Bnthe6xaC+1G2gTMfvgm2++EXaEAw16vXr1RA8betvwzDsZcIdBZy+gW2dTQZatACCR8wep/GqrcTn5QHgRrO4H57tkyRJZYo6GDRvS+PHjxbSosILxdzj8OXPmiHXgsbysm2/0JsDfG4GAOhAgmEK1G7qdkpfajeXLl1OPHj3o22+/lSWxady4MY0cOZJq164tS/QRBp29gG6dlfM3oXPaAQD+M1Q2UaWT/dVhNi7s3X/eeedp3dAkWXr16kUvvfQS5cmTR5aEA4y7L1y4UDh7HIsXL6ZDhw7JT8NJ6dKlxTK4CAZatmxJderUEc+lbnQ3ll5rN1AnLI/9yCOPiJ6kZMidO7cYervnnnvEG58Ogq6zV9Cts0nnD9IOAFSl0fUR71ck+6tRYZOV9gp488Qb+I8//ihLzACHj417sL5AWED3K3IrZs2aJbpkYb9MfIoUKSICggsuuIA6d+5MxYoVk5/YA22GjjFS4MV24+GHH6aHHnpI3qUG/tuBAwfKO3sEXWev4HedUw4A8OOIdJTzV2WxSOZXq0qHcUwJEf+TTz4p78xQuXJl0eV/6qmnypLgsnr1anrvvffEsXLlSlnKpAreSrDzHjah6tChg5iFkCpoCxB06W4svdRuoNsf4/poG9MB9fn6669FjkC6hEFnLxAUnVMKAPCjcP6oOCqt/tN4vyLRr7Z2d4TRuNDtjIQsu91GqYDNTkaNGhXo5U83btxIY8eOFU4fjSmjF8wogB0hGMCy0Oi+zg60A7oaS6+2G6hfkyZNRO+SHdAjiLYBdUyVMOjsBYKkc9IBAH4slvMH8X5FvHJUEt0cGFMKq3GdccYZIvHMBNAY3YsDBgwIpNY7d+4UvRpjxowRY/p2H0omOQoXLiyy2K+88ko6++yzY3Zdog1Am4G3Yh1jpF5tNxB0QgcdvP7663TDDTfIu+QIi85uEzSdk8o4QaVRWRw6Ih5VaZzDaFzY1Ce77GBdYCwXm6Fgjn+QtEb+BN7ysT1yqVKlqHfv3jR79mx2/gb5888/RQY7hgcw1bBv374RvS5ONZZebDd09jbNnz9fXiVHmHR2kyDqnG0AgEqjUVUBgB1UpdHdgXNYwVihXS2TAY0y5rK3adNGlvgfbO36xBNPiFwGdEN//PHH4oFk3GXz5s304osvUqNGjcQsgqlTp4q/i87G0svtBpJMdZHK73LCKYW9fY5FUHXONgCA80fFdbxZobKIeNIZ3woSOhuLeGDRly+//NKR+cVugLH9u+++Wyx/279/f9q0aZP8hPEaGIZBngASTUePHi3aDzv4od1YunSpvLIPElaTnZYKbTEWreOFgtvn+ARV54QBACqLiiP6sQuiHVQaYx1hB2+xToJMZDTCcJZ+B40h1ivAG/9TTz3ly9X4wgqmt2JoBlntr776Kh04cEB+kjxoJP3QbugcekK7m10bgTYZb6M6EtGAX3Q2TdB1jvktUGkYIQ5c2wkA0N2BSiMAcCvRwWs0aNBAXukHyViY616iRAlZ4k8WLVpEHTt2FD0Y2JwIDyDjT7DYFXptatWqRYMGDRJ7KmSHajdUY+n1dgNBty6wKFPJkiXlXVbQHqs3UrtOyW86myQMOmcJAFBpVBbOX0elVXcHG1cmTgUAyMj+5JNPxE5xfgS2h7FjrEZ35pln0sSJE20Fn4y32LVrl1j3AqsM/u9//6N169bJTyLxY7uhMwBI9LuUU8JbKbfPzhEWnSMCAFQaBypst+FFJdWbPyrPxpVJ8eLFRZSvk549e4qV7vy6rC9mKqCrGGPHSFxkggtmwQwbNkzkCFx//fUiv0OhGku/tRuY1quL008/XV5FYnVKeEGzg191NkGYdM4SAOh48weq0ggCmEyUcd1+++2yxD7oXh0+fLiILv3Gr7/+KlaXw5KzP/zwgyxlwgDamvfff1+88T733HOiwfVruwEb1hEEYG0FBPPROOWUuH2OJGw6H1sICE4fFcatLIp7BvGugfXNn4kEhoUxJWiNldSw81y6wMCQGIfuVL+Bt0BsmoIu4bBvxMMcpVq1avT8889T27ZtZYm/wIZeWMnPjj2//fbb1K1bN3mXiWo3dLycoW3m9jk2YdNZBACorDqAcujxziDetXL+PKYUCTRCZGk1Lrz9YvlQOMNUgc5460dj4TedsWofgpb169fLEobJBIs7oUegSpUqssQ/ICDHdNV0QL0nTZok744Sq92wg3JK3D5HEladcyrHb3Xi6YBKsvOPTTzjwtS2d999N2HGbyzKly9Pn376qe+cP96QsGocdpdj538U/P3y5cuX1Jr6YWHy5MkiURA746UzddBNENg+8MADKXf5XnTRRWK2ixWdTgl2xs4/NmHWOUdGxUUPAFBBQHZnYL0GaqyDjSsS6ATjSjSmhCVVsTMglrZNBHTF+CDeMgoVKuQbnTF3H/ujY6U46BBUsGVu9erVjx24x855OODkY11jcx31d4R97Nu3j/bv3y/O8a5///13+vnnn8Vuh2vXrg30EArWsnjmmWdE0OgnsNR39+7ds81rwZg/hj3ws1aSaTeSBfaF9pmz/bMSdp1zZFQ8Q4PEDj/6DNQ1KonKwvnzmFIk0CgV48L8/SlTptCyZctEw4GhATiLunXrUv369alTp050zjnn+EZn1P+dd94RwQ2Wig0CmGIJ516jRo1jjl5du7HLIoJ3BAQIBlRQoK4xxAT7CwKtW7cWAaSfVrbEG+XQoUNp4cKFYvVP/E3w98IMIOQKYBZEnz59qGzZsvK/OEqq7UYirE6J2+dIWGebAYCqNLq72LgigT52jAsNBZwmGgsEWH4zLizVe80119DMmTNliT+pWrWqWJcA69vjjGEbvwDbw/a0c+bMEStDYpMZP6+kiHbm0UcfFQGlH96uosFwBnpxMA04HnbbDSvs/OPDOh/FVgCAB5Kdf2xgWLoTSvyi82effSbyE7Zt2yZL/ANWq7M6/Oi3Mz+Dhg69SyogwHoLO3bskJ/6B+SRoGcp1dwZPxDmdsMkrPNR0g4AUFl2/lmBRogsdRuXH8aU8FDdd999YszWaiteBjsmYtoZHH6rVq3E1sJ+fLtMB/yNVqxYIQICDD8hsTSdGSluAOc/atQoOu+882SJvwlzu2ES1jmSlAMAVBKVhfNn44oE+ugyLugKjf1iXL/88gt16dKFvvrqK1niXdAFi30GkFiGaZjcWB5l7969YvllJKNOnz5d2LKXwd/qrrvuEvsL4O/nV8LcbpiEdc5KSgEAQGVVpZlMoBGMC2/BOseU/GBcY8eOpRtuuMHT48sFChSgiy++mC677DLxpg99/aazSTB888EHH4i/LbaVtrYBXqNx48YiaPFTfoYizO2GSVjn2CQdAKCSqCwqjoPJBPo4YVxe1xlJTbfddluW+cteAfsiYIlhvOmjq9i6T4KfdDZNtD1v2LCBJkyYIAIC5BB4EUyLfeONN+jyyy+XJd4nrO2GaVjn+CQVAAA4f9Xtz2QCjcJoXMuXL6crrrhCLO7jNTAt79ZbbxXTJjHXPhpuLOOTnT2vWbNGBHxvvfWWyGj3Gthc6IUXXhDrK3iZsLYbpmGdE5NUAMDOPz4wLN0JJV43rtdee43uuOMOzy1Ag81YsMkSVlXDwxoPv+jsBsnaMxavwhs35rl7bbYHVhHE0MUpp5wiS7xHGNsNN2CdE5NtAIDK4mDnHwm0QWSp27igcyLn5Saob+/evenNN9+UJe4Drc4//3zh+M8880xZGh8/6OwG6dozgkAsZ/3SSy+JhYe8Qt68eQk7DWJ7aS8RxnbDDVjn5EgYAKCy7PyzotO4YEx+yCbFeD+6/LFSoReAXkjo69u3r5i7nx1+0dkNdNgzulexkQ2637HqnRfA3xu9FNdee60scZcwthtuwDonT8wAAKCi7PyzoowLXUs6x5S8bFw7d+4Ub1JY0tRtsDQyGvSbb7456UV6/KKzGzhhz1hxEPtVYCqhF3jsscfo3nvvlXfuEMZ2ww1Y59SIGQCgsupgMnHKuHD2KlhnHl3sbif7wRaxuuCDDz5IRYsWlaXZ4xed3cBpe0YggGTMpUuXins3wWwVbLrjRiMexnbDDVjn1IkIAAAqzs4/K2E0LqwSh2l0f/zxhyxxByT3Pf3009SgQQNZkhzcWMbHlD3jd6Mb/v777xc9SW6CISysHojvaQp2SmZgndMjIgBQFceZiQSGpTuhxMvGhcVfsHDOrl27ZIl5sNzrww8/TFdeeWVaNukHnd3CtD1jzwEEAQgGdPyb6YJdBT/66COxMJQJwtZuuAXrnB7HAgD11m/S+eONYOPGjREHdpHDdyhTpsyxAzvi4ezGdqsqstRtXKa1ToWPP/5YvC25tS489MHKghi3Tbeh9oPObuC2PSNBEMMCCDDdAlvxYt+DEiVKyBL9hLHdcAPW2R4iAEBFna4wumXw0CNT+JNPPhFThg4fPiw/TQ6s5IbtWZGQdskll4h13J38zjqNC9/TD9mkWOQFztduN1q6nH322fTkk0/SySefLEtSwy86u4GX7BlTB++++24R8LsB2pHPP/+cqlSpIkv04bd2A8/6kiVLaN26dREvYuoae0SgTl5F53cz2V6ghwFBaKyX3VNPPZXKly8vf9I5cmQY6hGnDAtTx5AJjA1GMH1s+/bt8hM9YOc2dFN36NBBdO3lzp1bfmIf9RCja0nnmJKXnRKypQcMGCDvzAJjf/zxx6l9+/ayJHX8orMbeNGe4Viwv/+zzz7rSsCJISb0BKCx1YVf2g307iEAQtuMHj8/bgsddE477TTh23A4tahVjowIVfQA6GT16tUiWxvGZaobGUu+Yl44/t2KFSvK0vRw6iHG2au46fxh4FhIBuu5p4tfdHYDr9szegavuuoq+u2332SJOTDEhLffmjVrypL08brO+E5YHGncuHHC+eMFjfEH6LFCO3nddddR7dq1Zal9cmQYrbb+ky1bttAjjzwiEn3wILgBegFuueUWsS99kSJFZGnyhNH5Y5oWMu1RZ5NgSOeJJ56wvVALO//4+MWekWzas2dPkaBnGuwmiCDETp28rjPe8vv3708//vijLGH8COyhe/fuws8muw5KIrQEAPv27aNnnnlGTNXCtRcoXLiwMHisFGfdBS478ADrTijR3VjqBPU9/fTT6fvvv5clZsAb19tvv53UKn7Z4Qed3cJv9vzKK6/Q//73v5Tzg+wyZMgQuueee+Rd6nhV58WLF4tci7lz58oSJghgsyv4Nvg4Wz2ndgMAvO0PHDhQvP17kXLlyomx5auvvlqWxEZF8LofYq+PRUMb9JaYBG/8ePNPJTCLh190No2f7RlbDnfp0oVWrlwpS5wHPYdY7Kpy5cqyJDm8qjO2cMb+GOjuZ4ILerkx7I2ZNenYS9qr/SBCv+aaa0TGuFedP8AiNvieN910k3hQY6HzIcYfwWRjaRckQZmiYMGCxzaOsev8/aazSfxuz/Xr16evv/6aevToIUucB+3ZF198Ie+Sw6s6462/UaNG7PxDAKbSoycg3WnbaQUAmzdvplatWonG3C9gC1ssaRu9Gpl6iNGFp+MhRredX5wS6m5qmVY0SF999RV17NgxdDqbJCj2jD0fsOvk6NGjjS3a8+2338qr7PGqzmiT0Ta7Nb2ScQcEey1atBA9P6mQcgCAhTzQmC9atEiW+IdZs2aJhB+1rr31IdaduGOysUyXNWvWiKlYToMIdfbs2WI4Jow6myKI9ozZAXDM9erVkyXOkewuhl7UGUEIxoPR24ktmpnw8c033wjfjFktyZJSAPDhhx9S8+bNXV8b3g5wetg3HosROfUQ+wWnp11BF8zxxs5wIKw6m8BJp+Q21apVE0lseLN1Emx8lR1e1BnDF1gYDXk1TLhBz0/Lli1p/PjxsiQxSQcAI0eOpMsvvzwQc0d3794tFpxBt4ndhxhgpS4/OiWd80mjQXcmum8xJRNjpGHW2QRwSkHWGZnOn332GXXu3FmW6CeZ58GLOiMPCwutMQxAD1DXrl2T6qVPKgCYN28e9enTR0S/QQEPcK9evWxPf4OjU2N3fgPLTmI1NN1gUaapU6eKxlpHghTws87RwPYQhGK8DpnuSHhbvny5WIoVK7KlMgUOzyTeRsOgMzL1sZANEnqdINGKgF7VGdOvMZ2WYaygDUG+VaLeethxttMA0ShhXEH3Mr5eAePSc+bMoeLFi8uS5ED3ndNrdJvgwgsvFG9WusDa1nD+yOTW0Vj6TWc8cD///DOtWrXq2IGkWayPgXwLHMn0oqG+SH5TBzbCql69utgjoUaNGuKMdeyhSRh1HjRoED3wwAPyTg8ILtDLGQ2aSPXm7yWdMYMH+6LoCEiYYIKNr+bPny/WDVDAnnFkGwCg0cJ4+Q8//CBLggk2FUIXGrrjkgEPLbrt8PN+dv5gzJgxortIB3BI06ZNE0sx6x4j9ZrOcAYLFy4UwSOSSuHo4fj3798vf8J5oE2lSpXEMqEIDhCon3XWWVSsWDH5E8nhV3sePny46JnU0R2P3jCskocFxKwo5+81e4bNod3as2ePLGGY2CCoRXALrM4fxA0A8APoQpg8ebIsCTbInsUqZNlhfYhxDgL4O2PfBjsg0sSbf9GiRT2VIKUL1AfZ6DNnzhSzSRBVu7VdciKgW506dUQggKS5Zs2aJZxG53d7RvuERYPs/i2wVC7epq045fzt6ozu3bp164o9VxgmGZCM3a9fv2POH2fYZNwA4P7776fBgwfLu3CApYx79+4t77Li98YyHlu3bhVOI91hHuzEOGHCBNHNFCTnj4xazHyB08c0Rozb+w3oh+AMmcFt27YVO4wpgmLPWMcfu4JiP4F0wNrqb731lrw7iledP0A7ddddd8k7hskeJNEiYMRQonL5cQMA/CAyYvEAhAkkr2EZ0nj5ABi3w+HnxjIe2B3syiuvzLJQUnYgYMLKfjAm3QlSbuiM8XlsSPPOO+/QjBkzbDf+XgNDBXhjxoEhm6DYM7rv0dW5YsUKWZIc6CHB8F901z8cvxftGUEOhnzSDXaY8HLbbbeJKdloq4E4IwCIpnPnzggKQnlkOLQje/bsyXIcPHjwSEZAdCSjQZAqBY+MN94j7du3j6lL9FG+fPkjn332mdAjo6E8sm/fvpi6pXq4oTP+rVmzZh3p0aPHkQIFCsSsb9COjIf/SMuWLY+MGDFC6B4EDh8+fOTee+89kuFoY9bZeuTJk+dIxpv0kYwAT/7XR/G6Pd95550x68MHH9kdJ5xwwpGVK1cK+8aREeQeydIDgHWkkVwSVhCpY1qW2hQEUVIQsv1TAcuJDh06VPSGWFcKxBsMMtDPPfdcevTRR8XYMnqJdLwpuaEzhj7QezFq1ChX9qL3Chi6QR4I3hCwUqbfwZLTDz30kFgZLXqfEsz6wdbXmEUQvRMlmkIv2/P69evF7I9UpokyjBX0kqkl/GGTWQIAjBWa3DoyV8ZDUveMM6lc5apUrHQZKlaqtHgQt2/aSNs2b6Q/1q6hH75apKUrLlkuvfRSMSYIgeD0MHYXFudvBX8HrJyIOeplypQRy7HmzZv32GdoLHWPkZrQGVP10BU2bNgwTybyuUmbNm1owIABjq+6ZwrkcWCJX9hWgwYN4s6Q8IM9d+vWTQxNMUy6wBYXLFggcoFwHREAYCwMyTROg3+4+QXtqHXHy6j5he2o97fd5CexebXeSJr/6cc0Y8IHtGjGNFnqHPh+2BkMbwp4iPEwM5k41Vg6rfPatWvFcqlYOAVveUx8mjZtKgKBiy66SJYEFz/Y859//ilyk/A9neTEvPmoybkXiHa5TMXKVDzjpSxvfj2bMUHnf//9h/79+5+MFzqbuTXQOWcuOg49LD5tn49kvNTu3LZVvOz+9N3X9MXkCbR6+TL5qXNgl01s4x8RAOANG294qSbRpEqjVq3plkeeoId3PSRLUuPefPfSSwPuou8XL5AlzoCeEGR/s/OPxI/OHzb9+OOP09ixY21/57CB1fEQCKBXDH+voOEXe8ay2ldffbW80w96Krrc3I963/8IXbeoiyzVx5izJ9O/GTr/k6HztYuukKXpMbLxexnfNxcdn6Fz1zkdZGkwePCkh+iRG6+ltSuWyxL9IJDEvhew0WPrUGKak5POP3/BQvTkex/RjttPTNv5g8f3P0777itCDw17h/LI7mgnwAIvWNyFiQSNJd6edThSjJE66fwxrfG6664Tc6bRgLLzTx10n2NJZwQCWPgoaPjFnp1cj6V81er0+rS5tKjNz444fwDn//fff9l2/iBXruMC6fwBfOPbc7+ma+8aIIbHnWDbtm1iGAAcCwAmTZokr/RToVoNGjl7Mb2ed4Qssc+oEu/TG9PmUYmy5WSJfpzUxG/gTQlvSToSpACSo1SClG7wXdHFhYQp7CkvO7kYGyAhFFPmrr/+erFfgd/xkz3jO2LZXyfo3PtmGr1wGQ05MESW6AVv/u+0mCCcv47g4u2m40S3fw4HdPYK3eZ3ojnNl9HIWYtEcOYEKqA8NgSAJUWRZaqbkxs0pFenzqLrv9bffQXj2rrxD7rxgpa0Yd2vslQfyAHArIiwAxNRb0pezI62snTpUrrxxhuT2gmLSQ+s9ohcCvSu+HFYwE/2DLC89gUXXCDv9NH0vAtp883ODb2pbn8dzh/d/njzV87/qi/ay0+CzaBSj1P3FqfR3xm2qhPMcsPS5SKMQqPphPM/qXgJeuq9iY44/9GtJgnjKnRSURo86gNtiSpWMJ1o48aN8i6coIFUY6Q6Gkt0jzrRWO7Zs4f69u1Lp59+Ojt/h0EPAHbSbN68ue3dNE3jF3u24kRPJIZk73tpmLzTj2qfMeavw/ljzD9szh/cv/leun7Aw/JOH7/++qvY40cEAHbXgY8F/lhPjB5P/X7Wv3UnIsv//v33WELJI7sepoGvvSkeQp3gTSEseyHEAvXH2KgTCVI6G0vsQVCzZk168cUXeZzfIGo6Uf/+/YWNeB2/2HM0S5YskVf6uP3J5+m2lX3knV6i22c7RCf8hcn5K67pexed0kj/2jywK8cCgE69bqQhB5+Qd/pQ3UrRxvVGwbeoTSf7CSbROKGNH1DdpE40lrrAd7vzzjvF1FXM92bMAxvBcECLFi0c6UXUhR/sOR4bNmyQV3po0uZ8Gl16vLzTS7z2OR2CnO2fCqj7wKFviZdqnaDNzImHFgk+OslXoCBdd4/evboVakwplnFdd/cDdEKePPJOD1gPwLoaXlhAY4kxUh1v1E5kR8Nu4XSeeeYZ0bgz7oJcGSy0g30UvIjX7Tke+N5YsVIneDlzikTtc6oEOds/Vfr/fic1bKF3cS4Mb+fE+L9uru53F9247Fp5pwdEltllk9638W7q0ON6eacHNBrYaCQswJniLUlHghTA+KgaI9UFnAycDSdoegssVoP1ArCkMOzHC/jBnhOBtzQd31uBhX4an3OevNNHMu1zKoQh2z9VzrpI7/CH6AFwIsmtXdce8koPqlspGeO64PKr5JU+wpIIqLpJdTSW6Ca1NpY6xkjxveBc4GTgbBhvgv0VsJIgVl50E6/bczLo7v6vUa8B9Vh4ubzTQyrtc3ag29/q/MM45h+POqfr3adDBAC6x05rNTyd+q7S18WUajbpoL2DqVS5CvJOD7o18iJoINFY4m1JR2OJ7lGdjSW6QZF1Dufid9CwnZC/AOUrUYZOqlSDStQ+lYpWq0MFylSgPAVPopzH6R3rcwNsxNOwYUMxhc0NvG7PyaI7AChaqrS80oNT2f5hTfiLB4IszKrTCfxajp49e2JLUFlknz4DB9Hnp+mZhqUiy1QTShpMLksTRgyVd/bBUqjYPSyoqDclryZIYcrKeeedJzYm8gMn5C8oHPuxo/LRc/7ipem4PCdSruNPoCm/JW4szy/xJv19YB8d2r2T/vxtLf25fk3GOePIOO/KOO/f6o9eKThNbKx11VX6e+bi4XV7ToXXXnuNbrpJ30wqjP9/d/Hv8s4e6bbPseCEv/gonQ8dPECtyxaWpfaBTWsfAji5fkN5ZQ87xlX9lPrySg9BHgJworFEo6+rscQ8c6xA52XnX6hcZTqlc0+66OnR1HvOH1Ru9FmUb3Ap+uv6PbTl3K9pZbUxVLJ2QzqxSHHKdULubJ0/mLb1Wpq171ZakOtB+rHyKNrYagEd6LaVTnigIF332Sq6ceFW6jRiGjW+4T4qXb8J5XDBOSUD7Apr2L/wwguyxFm8bs+pgkWXdLJn1055ZQ8nnL9682cyseq8e6feFTiLFCmiPwDA7lE6QKXTzSYtWlJvN1eQAwA0lhgj1ZEdjUYSUSWypHWAbanPOusszw3BnJCvANVseyWdN2g49Zr5KxV9pQ4duGYLraz+Hs34M/bc6v/ELmh/0ZT19hpLkCOjscxTsAh9V+wl2nbR93TiI8Xo5sU7qcPrH9NpPW6nwhWqyZ/0BnDK/fr1Ez1pTuNle06HsmXLyis9bN+s51my0z5Ho978r57bUZYwCuX8jxz5T9vfTlG6dGn9AQD29LcDIh672aTFSpWSV3oIYgCARhlvSToSpICaGqUrOxqrn51//vm0e/duWeIuGLev2Ow88Zbf58st9FfvvbSm7kTxlp6IDjUmU/uqE4Tzn5rEm392tKv4gRhCiM6O/mRDV/q+9FDa1XE1FXmpJnV570uqd8UNlLugvi5Duzz22GNiLwEdzjkar9tzuugOANasWC7a13TR0T5beevMD4Tz52z/SJTOyvmDNT/oXXWzTJkylBM7pumkcNFi8ip1VHeHXeMqWERvt5lujdxGdZPqyo62Npa4t8vIkSOpU6dOdOjQIVniHkWr1aYWdz5B18/+nXLdfYJ4y5+yPrksajh/9eZv1/m3Lf9ehPOf+HPiBKkleR+nfVdtoD7zN1O7596nKq3aemKYYPjw4WJ3wcOHD8sS+3jdnu2ARlrnd9j75y76dt5seZcautpngG5/q/PnhL9MlM5W5w++/GyqvNKDCADw8Ogk3T+ktdJ2jUt3NKnjjcIrqMYSb0s6GkvVTaqrsRwzZoxYZ96Jt8RUKHt6C7p02KdU6JkqtKHFPJqx6wb5SXIo5//fP39rcf7o9k/W+Vv5+NfO9GOVd4huz0HXffYz1bu8t/g9boLVNa+88kotf2Ov27Nd8F2KFUv/pSoWk98ZKa+SR2f7bE34Y+cfiVXn//77V9g32L5lM309d5a41oUIAOS1q1grrSOhJFeGcTFZsTaWdhtf1ViqBCkdjeVnn31GPXr0OGb0blCpxQV0xeh5lPuBQrS0xCuyNDWszt/umL9y/jkzdJ60pkNKzj+aLw70pX1dN1LPGb9Qw+796Lg8eeUn5sFiTti10Q5et2ddoKHWyfQPx9Itfye/D4Du9pmn+sUm2vlbeep/t9DhgwflnR5EDoC8dg0njCvX8e4l7XgVpxpLXQlSWNUPXcP4fm5QrU0HunrCN5TzzuPoq/zp72HhlPOfvEZfghQSFf+8dA1dP2sdndH7XjE10Q2GDRtG999/v7xLDa/bs05OPfVUeaWPx27tTW80HCXv4uOU8+eEv0gSOf9P3nuHFs/Qv54GVlN1PQBApXVnk2INaSYSNJZezY7+6aefqG3btrR//35ZYg5kzF86/DP679Z/xJQ7u+jO9kd3vU7nb2Xatutoe9vl1OOTn6jqOe68iQ0ePFjs4pgqXrZn3bRvr/9vs33TRnrm7r7yLj5OtM/s/LOidI52/lv++INefuAeeacP9CqdccYZ7gUAiHg4m9R58KaEtySvZkf/kWHgyPbHHvMmwXz8M295iLpP+YGWFn9ZlqaPqWx/J5i19xY60vc/MY0QaxqYBlME33vvPXmXGK/bsxNgEaw8mjc5A59mvFm2W95StMXRcPtsBqvOR6LseeuGP+jh3t3owD79m9EhqETPlyt/DdXdocO40K2EtaM5oSQrqptUV3Y0ukhVY6ljjHTnzp2icfv9dz0rkyVLpebnC8ePRXqQJGcX7dn+lcallfBnF0wj7D5lBTW+8X4RIJkCdtq9e3f6/PPPZUlsvG7PTpEvXz5q06aNvNPLi/ffRX0uaElPVX5elnD7bAqrztHOf+rot+naVo3pp+++liV66dDh6IJLxgMAVWmMdejKJuWNI7KiGku8LenKjkaDqauxxPfr2rWr6P43BZxa6wdfpZx3HU+zD94uS+3hSLb/cUft2aTzV2CK47YLltJVHywWyxebAnZ6xRVXiGWfY+F1e3aaSy65RF7pZ+mCedS1ST3q+PN5jq3tz+1zJFY/aHX+2zZuoLuv6khP33mrI2/+oGDBgnT22WeLa1i+1pTrKpPayausWCutK6EEkWX08pEv1xlGF1XTtxpgyZIlafPmzfLO+1gbS10JUnhTwlkXTzzxBPXv31/eOc9JFatTu+c/oC9zPiBL7ONEwh/e/JHt7wUuKjeGZgy8gVZOTa57XgcYl5w/f75wzgo/2LPToP3BuC20cJLSFSrRWe3aU5PW51Pp8pWoSEbb12dp6ru7Jmqfw47VD+7etZN2bNlEPy/9juZ+Mpm+mjOT/nJ4/ZMuXbocG3IzFgCYcv4gzAGAHxrLBQsWUMuWLcX3NMHJbbvQuY+8QZ/8oW9DmqA7fytVl7WnLx7rS/8c0jsNKR633347Pfvss+KanX8mF198MU2ZMkXemQGaoZ3VSsbvLFe5KtU89TSq2eA0OuWMJjRo96PyQ28w4owx9NXsmbTyu29EN/zKpd/S/j16VyVFTxb8oWlmzJhBrVu3FtfGAgCdCSVqv+h4kWWYAwA0lLoSpPAWhkNnY4lxf0w/MTHuD4d69gMv0S/1P5Yl+tCa8Icx/+OOzvP3Ks1zPEYf39aZdq37WZY4y+TJk4XD87o9m2TFihVUv359LTMfvMa5na6gu559Ja3eBt3ckbMfDbrpOtr8+2+yJDgg4RrrrSgczwHAm79y/hnhvCxNH+X8MabEZII3JScaS93Z0Vjox4Tzx5a8HYd9qt35a8/2l87f6/Y8/8h9dOXYBVS6fmNZ4iywE+QDeN2eTVKnTh2RLBlEpo9/n7o0qkM3HbpelphnZJOx1HBqRbq1/bmBdP6wfQy9WnH0abB2+8P5X7f4SvlJ6qDb3+r8OaEkE9VNqjM7WjWWuNfFc889Rx9/rP9tPJq8RUvS5aNm07cnPSdL9OBItr+LCX+p8tmWHnTZ27Oo8lkXyhLnQE8RlguGTdvBSXt2g0ceeYROPNGdhZucZufWLXRXlw50e47s1ydwgod7d6cP33hFtKdBBNtyowfJimMBQPSYv13nz9mksbGOkepw/ugedaKx/O677+iee/QvaBFN4QpVxZvqglwDZYkegpbtny7Id7jktclU+5JrZIlzYHXIIUOGyLvUcdKe3QK7AyJHIqigPRt8c08a3mi0LDFD921d6ItJ4+Vd8MA6Eo8+mjXPwpEAwMmEP3b+mVidv+4EKZ2NJQKTPn36iO/pJCVqN6Qu7y0Qa97rxMmEPz85fwVWJrxgyNt0+nV3yhLnQK/RqlWr5F3yOGnPboNAGnlJQQXd78/3v0PeOc+LNV+np/93i7wLJggaK1SoIO8y0R4AmMz2DzNOOn/dYM33JUuWyDtnKFb9FLrsrZn0+faeskQPYcr2TwUELjsvWUmnXfs/WeIMsO877kjNGThtz26Dedzjx48X9Qsqk0eNoJdqDZV3zjL21Rdo7+4/5V3waNWqFT388MPyLhLtAYBy/tZ9jNMFa/qz84+NGvPXkRGslkN1orHctm0b3XvvvfLOGQqUriDW8/90k/5uaTXmb9f5gxwZ9hwE52+l5d1PUa32V8s7Z5g3bx598MEH8i57nLRnr9CsWTN6/fXX5V0wcWoVvGhM/TtuUKVKFfrwww/FMFgstAcAupw/Z/vHBm/+eCvyS3b03XffTbt27ZJ3+slTuCh1GjFN7HCnk7Bm+6cKegLOf2yk2EbZSe677z7as2ePvIuP0/bsJa699tpA5wP89N038so50GO9aum38i5YFChQQEynLVq0qCzJivanxK7z52z/+Khuf69n+yuwotvbb78t7/SD/ew7Dp1Kc/++S5boIezZ/qkyee2ldPGLH1KpemfIEv1s3bpVZMDHw4Q9e5GnnnqKLrjA2eDLLbAIj9Ns+HUt7dO8wI8XwDMwevRoMXU0EZ4KkznbPz5w+H7I9lfgu950000iaHEC2MfFL4yjxXkGyRI9XFJ9Emf7pwG0QjCG7ZWdYsSIEbRs2TJ5l4kJe/YqqPfYsWPp9NNPlyXBYdumDfLKObZudP7fMA3s//nnnxcLaWWHZwIAzvaPD5woxvqdSPhzqrF85ZVXaPny5fJOP01uGkjLSr0m7/SAN/8j//3L2f5pMm3rtaIn4Ljc+reuBbD96IRAU/bsZQoVKkRz584VmykFCadeHiIw8W8YJH/+/PTRRx/RrbfeKksS44kAgLP946O6/f2Q7a84dOiQrfnb2VHhzNYZAYC+TX0AZ/vr4csc91Or+zK3ltXNV199RTNnzhTXpuzZD2BxIPQEDBo0KJRBEENUsWJF+vLLL1PaOdITAQBn+8fHL9n+VtBV69TeCfmKlaKLnh5Nk1br3R6Vs/318UuDKVSzbfoLf2XHk08+Kc5hyPZPlQEDBtCECRPEmyATHjArBFOt69WrJ0uSw/UAgLP9Y4M3fz9l+yvwnVUDrRvYyEXPjKHPt/eSJfbhbH9nOPfRN+ikSjXknV4WLlxIixYtMmLPfgPtRtu2bUUvyWmnnSZLmaCCZwAzQWbNmkUlSpSQpcnj2tPD2f7xUd3+fsn2tzJq1Cj67TdnNtJAt/83hY9uE6sD09n+F5Z+h1rkeoIa7uhLNX66jMrObU6FPqxCxw/NR/neLUUlPm9IVZa2o3obe9OZ/zxE5xZ5gy6pNlH+1/5i6u9XUrsXMvQ43pnFarCpSdgS/rLD2m7UqlVLOIW33nqLKleuLH+CCQqwe+zrv3LlSrF1NnrC0gFPj9YsiNmb98orirv+v3XM3wnn7+ftgJ0a8zfRWOL71qxZk9asWSNL9FGkSk3qNvl7MeVMB06N+Vud/7lFh9HaWZNp7YyJ9PuSOfTPoQOiPBVyZPz9ilWrQ1VbX0LV2nSgBbkelJ/4g+Kf1qfFrw+Wd3rBXgFnnOHc1EM/kajdQNnIkSNFXs6OHTtkqfepXrc+/TuovLxzhruO/x/deNHZ8s4fnHPOOaKXVUcPj/EeAM72j49Tzh9nE29K77//viPOH5wz8BXvO/8MnXetX01l57Wggw/uoKEtytCMgTfQr3M/Tcv5gyMZdrBt1fe06NVH6d1LT6Ntfb6nQuMqU8Ndt1P7ah/Jn/Im0LlRr7upQJmKskQvSHhjsm830Pt3ww030Pfff08DBw5MeZyYcZ98+fJRp06dxF7+Ood3jPYAKOePbv+r53aUpfrxYw+AE84fDz4SpUyA71+3bl1asWKFLNEHEsr+6p1pV3ZwwvnnzNB49ecThJPesUZ//eORp+BJVK9LH2p0/T306UZnl+NNFavOa2d9TFPvsJ9fEYulS5dm2eI0TKTbbmCYburUqTRlyhRasGCB7TbHCcLeA1C8eHFq3749dejQgdq0aSN29NON0QDgrTM/MJLt78cAAA+wroQ/N7KjEZXCSHVzQv6CdO2nK2n6zt6yxB5aE/4qfkAbv1tA857pT1t+cG89cSyH3LjPAGrQ9Wb6+JdOstRdonX+75l/ad3cT8W1Tnr16iU2mworOtqNnTt3inyB33//Xay4uGnTJnFs3LhRnPH73SAMAUDhwoWpTJkyx47SpUuLc8OGDalp06Zi6NZJjAUAJhP+/BQAqAhet/M3nSDVvXt3kQCoG8wp/63xDHmXPuqNVJfzb/LXQFr44kD6dd5nssR9CpatRM36DaJa7a5ybeGheDq3yDmERl/WiP45dFCW6AGL4ODZdOLtyMuYajfw7+DfwDk7MMTQuHFjeWcfPwYAcNoTJ8ZP3LXqjGv00rqJ4zkA6PbHmz9n+2dF50OMh9Yt579//36xPaluCpWrLN5q7aLT+bcu9CrlHl6I3ruiiaecP9izYR19etfV9M6lDemMA87uwBiLRDrP+68/1b1cTy+Old27d9OkSZPkXTgw2W7gPnfu3CLAyu7A7wg70DCWNlioCWszYCvnvHnzinu3nT9wNABwOtvfz6iHGF14Oh5ik9n+0WDhEQQBusHY9uQ19nJFrGPRdp3/mX8PpPevbkk/fTyajmh463KKbT8tpQ+uaUVVl5l73pLRueE1tzqyTLATPU9eJUjtRljwss7OBQCi0seJN3/O9o/E+hDrTPjD2Q3jcqIBzl+yLNW59Fp5lx5Wp2Q34a/2r91oXPfWtOePX2WJt0Gdpw/sTQU/qOT4bIFkdf7iQD+qfUk3eaePzz//nLZs2SLvgkvQ2o0w4HWdHQsAchnI9vcjTj3E6MZzgw0bNogEIt2cft2dthLadDr/kjMaiSz2v/brmYlgkqWjX6YJvS6gC0o5sy1zqjo37N6Pch6nt+sTz9OYMWPkXTAJWrsRBvygsyMBgPXNn4kEDzHG7nRMu1Fjd24aF/ac1pGEZOXEk4pRvSvsjRfDKWEs2o7zP6/4SDr+9by08KUHPd3lnx2/LZxJYy5rTGcdp3+J5lR1nvvP3VSzrb2hmFi888478iqYBK3dCAN+0Fl7AKCcP8b8mUwQwSN615G4AxBV4sCYkps40f2Pt8R0HTfeSHVM9bug9CiaevsVtOrTD2SJv/nztzX03pVNqeUJT8sSe9jRueG1d2hvH7777jv64Ycf5F1wCGq7EXT8orP2b8fZ/llR3Xe6snatxuXmmNK6deu0L/yD1fRO6dxT3qWG6o626/zB/Gfupd8XfyHvgsHhPX/SxD4Xi+DGDnZ1XpDjASp7+lnyTh9Y1CZIBLXdCDp+0ll7AMDOPxLr2J2Oh1iNKXnBuJwY+6/U7DyavuN6eZc81rFou86/4pJz6fv3h8q7YIGliqf0uzztxEBdOjuxXbAT9ugWQW43vAR01gm09ZPO2gMAdv6ZWB9iXYk7GFPC2QvG9cUX+t+Qa3foLq+Sx+qU7Cb81d9yE8154k55F0x+WzCDZj92u7xLHp06Y2Oj40/MJ+/08OWXX4q3Zb8T9HbDK4w5G/ZsP6fCitLbLzrzQJBDOPkQewXdb1y5CxQSu96lgk6n1IweEwvp4HcFHcwOqPJdW3mXPTp1xh4KJ+QrQNXP07O5k+LAgQNih0A/E4Z2wwvA+f+bobOOpEorfguwOABwCDzEeBvRYWAqm9RLD/HPP/8s1grXSY0LLqMp6y6Td8kBp5RKFno8kPE/9Y4r6NDunbIk+Mx69FY6Y39/eZcYXTqDHLmOE7snptPbkx1O9EqZJOjthleA8/87w57/+09vAOA3OADQDCJ4RO86EneANaHESzgx3prKIjF4I9W5sc8P44bTzrU/ybtwAKf+xeC+Qst46Na5XaVxlOu4o4nC5RufTQVKlZOf6MGveQBhaTfcBm/+77SYIJz/dYvs27PfYevQiOq+0/EQoyvJ+hB7rWtJ95sWuv/LNGwm7xKjuqN1OCV0R59bdBh9PeIpWRIutqz4hlZ98r68i0S3zlbnj82KJq2+hCq1uED+hB4WLVpEBw/q3XDIacLUbriJ6vZn558JBwCasI7dBT1rF3XVHQCUa9RSOITsUE4JY9E6nBL28/96xNN0aM8uWRo+5j8/gC6uErmZkxM6W52/onyTc+SVHg4fPiz2t/cLYWo33EQ5/38ydGbnnwkHABqwPsS6E3e8+BBj/v+2bdvknR7QHZwdVqekIxENTunAjs0iIc4kFSpUoKuvvpruueceeuGFF2js2LFiT/uHH36YbrjhBmrSpInRv/vu33+h78e+Lu+c0Rlj/pPWdMiyTXH5M1rJK30sWbJEXnmbsLUbbmF1/tcusp/DEiQ4ALCJkw+xV1m5cqW80kd2AYBTTmnBSw/Rv38dlp84R9myZYWDx4p169evF0vXDhkyhG677Ta64oorqFevXjRw4EB6/fXXaeHChbRp0yYaPnw4tWzZUv4GZ1n06qN0UdnRjjr/WEzf2ZuKVKkp7/TghH3qJozthhuw808MBwA2wUMctqzdVatWySs95ClclIqfXE/exQZOSXcW+o61P9JPk9+Vpc5QqFAheuyxx2j16tXCwTdo0EB+kpiSJUtSz549afbs2fTJJ59Q3bp15SfOcHDXdvpqxFOO6BzP+SuS6f1JBd326QRhbDfcQI35s/OPDQcAaYIIHtF7GLN2db9hoRs4umtYgTdSp7LQl48b7ugmP2effbZw/Pfeey+deOKJsjR1LrzwQlq6dCkNHjzY0a5dzIRAb4hunbNDdx6Al3sAwtxumISz/ZODrSYNVPddWLN2dTewpeqdIa8iUd3RTmShZwhNa2dOkp/qp3fv3jRt2jQqXry4LLEHbOO+++6j8ePHU758elfQU+zfvpk2LbO3kE60zvECOyul4/z902X37t20efNmeecdwt5umIKz/ZOHA4AUsY7dhTVrV3cXa5HKJ8urTKxj0U5koW/7aSnt2bhe/oRe4KiHDh0q/q666dixI82cOdNWj0IifpkzVV6lTiydk6FAqfJ0XJ688k4PXhsG4HbDDJztnxocAKSA9SEOa9auE29XJ0UFAE4moimntGbmRHHWzaWXXkqDBg2Sd87QuHFjevPNN+WdXn75Ir0d9eLpnAz42ZMqVZd3evDSMAC3G2bghL/U4QAgSZx8iP2E7oY1Z67jqHCFqvLOWedvZc0M/QFAvXr1aNSoUUYaZcwcQE+Dbv5cv5rO/OcheZcciXROlqDOBOB2wwzs/NODA4AkwUPMWbsZjnPNGnmlh0Llq9DktZmbwpjIQj+nwMu0beUyeaeP1157zbHx+Vg8+OCDVKVKFXmnj19npzYMkGy2fyKie4HsottO04XbDTNwtn96cACQJJy1e5Rdu/SumKfe/JzM9o/GieS/Tp06UdOmTeWdGeAMMDNAN6nkAaSS7Z8I3T0Auu00VfDmj7d+bjechbP97cHWlAR4mDlr9yh79+6VV3ooXLG6o9n+scaid6xeIa/0gL8nFvVxAwwFJLu2QLIksylSMjqnwkkZdqAT3XaaCqrbn7P9nYWz/e3DAYAB1NhdEB5i3Q1rnkKFHc32j8W+rXq3MUZSXrVq1eSdWWBLXbt2lXd6+Gv/Xjq36HB5l5VkdU6F3AVPkld6cCsAsI75c7a/c3C2vx44AHAY9RCrsTu/P8T79u2TV3o4/sR8jmb7x0J3ANC+vX0HaIcOHdIfe4/H/u2b5FUkqeicCifkKyCv9KDbTpPByYQ/dv6Z6Ez4y5HxvzDDAYCDRD/EQUD3mxXmfzuZ7R+L/ZoDgIsvvlheuQN6H+rUqSPv9HBgW9YAIFWdU0F3AGC6B8BJ589kotP5j2z8HuXMFW4XyAGAgwQxa1d7AHCi/QVgUslCv6TaRDqwc6u8sw/+trVq1ZJ37qF7r4B927Ku9aAj2z8eU9ZfLqaE6uLQoUPCIZtCjflztr+z6Mz2zwV7Pk7/Yl1+ggMAh7Am7gQJ3QHACXntvfmlmoW+f8cWrev/Y9MeL/yNy5QpI6/0cCAqANCV7Z+I4/Pll1d6MNELgDd/zvZ3Ht3Z/m83HUfHZegc9qEVtjLNwKCsD3HQDEx7AJBm1y+6o9PJQtfd/a/b8aaL7u+xTw4BpKtzOpyQr6C80oPTAQBn+5tBZ7Y/uv2POX/WmQMAncCY0G0X5IcYbzs6yZlGF9yxseg0nNLfB/fLKz2YXPgnEbq/xz+HDtjSOR1yZTw3OtFtq1Y4298MOrP9xZh/hj0r53/VF87asx/gAEAT6iEOetZu/vx6u2n/PphatnZ0IlqqTilfsVLySg9e2XVO9/fIW7SkLZ3T4a/9ejP3nQrOONvfHFoT/jLs+fgMnbvO6cDOX8IBgAaiH+Igoz0ASKHRj3b+6ZCvhN6u8o0b9Q4ppIvu71GgRFnHEv7igfUHdFKggN6ZBYCz/c0htHbA+TOZcACggTBl7epuVP86kHwAoCML/ZM/rhJrD+gC48zYIdFtfvvtN3mlh/ylyxl1/pidgWEHXaAr3YkeAM72NwcCAF3Z/uz8Y8MBgE2siTthQHcA8HeSb306s9Dza+4FmDVrlrwyDxpJBCHz58+XJXooULKsvDJDKoFgMujuqYLOeOvnbH9/YU34YyKBHbMqaYLuO+tDHJaxO+09ANkEAE5koeseBpg8ebK8Movqjp42bRrt3685udF0ALBvj7zSg047VTpztr9/iM725zH/TGDPsGMOANJEjd2F8SE2OQTgVBa67h6AqVOnaukSTgXllPBWqjsAyZFh23mLlJB3ZtA9/q+rB8Cqsw7nH9Z2wySc7R8f2LMKAAAHACmiHuKwZu3q7lrdt2WDvIrEbrZ/IvKXKiev9LBt2zYaOXKkvHMeq1PC2P+HH34oP9EDAqRJqy+Rd2bYt+UPeaUHHYGqVWfO9vcHnO0fH6vzxxlwAJAC0Q9xGNHdA/Dn+tXyKhMd2f6JqHBma3mlj4EDB2rvho9FtFMaPHgwHTx4UH6qhwpN9OuTHTt/XSWv9GDXTp10/owzcLZ/YqKdP+AAIAU4a1f/inO71mUNAJxccx6Ub3w2nZBf76pzmIc/ZMgQeecccEoqC3358uU0ZswY+Yk+qrUx33ju0hwA2LVTq8524XbDDJztHx/YMY7oYSwOAJLEmrgTZmrWrCmv9HBo9046J/9L8s7MmvMf/9KJKp91obzTx+OPP06ff/65vNMLona8japENEw97NatW5YH2i7H5TmRKjY7V96ZY+cvK+WVHtK102id7cLthhk42z8+yvlb3/wVgVQrVkXtwok7R6lcubJ4m9EJhgGcyPZPRLXW+t8S8JB16dKF1qxZI0v0AHtWb6RwSvh3evToQWvXrpU/oY+Kzc6zvT1zOujuAUgnAIjW2Q5oJ6zOn8f8nYGz/eMDe07k/EHgAgCxdvS/ercBxcPLD/FR0I2J/ed1gmEAJ7L9E1HprAvT2ocgO3bt2kUXXnghrV6ddWgjHZRTwlspnBKc04033kgzZ86UP6GXaq3NJv8BBH97N+tNAjz55JPlVXJE62wHtBN4Ttj5Owtn+8cH9qxeFuI5fxCoAEBtHPHv3/r3AeeHOBPdwwA7f13pSLZ/Ij7deLXIBXAC9AA0btyYpk+fLkvSw+qU8CBjtkHbtm1p7Nix8if0gul/Vc6+WN6ZY8eaH+WVHuB0q1evLu+yJ1pnOyjnr8b8ud1wBs72j4/V+WcXzAYmALDuGvXff2bnZIcJGFeNGjXknR42fDPf6LKzihrnd5ZX+lE9AQMGDKA9e1Jf5CbaKU2cOJFatmxJixcvlj+hn/KNWtK0rdfKO3P88dUceaWHSpUqUZ48eeRdYpx0/owzcLZ/fGDPsGPYdDI9WYEJANR+0TrWjmbiA8OqUqWKvNPDtpXL6MLS78g7c9Tu2J0Klq0k7/SDB/Gxxx6jqlWr0osvvkiHDh2Sn2QPdEZ3/+zZs+mcc84RCX9//KG3mzyaJjc/KK/M8vuS2fJKD6l0/yud7Tp/wNn+ZuBs//jAjnEkO4zl+wAAb/7vtJggnL/d/aKZ+CCyxFsSGstUuleT4UiGsf7x9Vx5Zw7MBmjWb5C8c47t27dT3759qVixYtS5c2d69913acOGDTGdDnoOZsyYQf369aNatWqJLv+vv/5afuocVVq1o68LPiXvzNG+2ke04et58k4PyQxRWe052cYyEdaEP8Y5ONs/NqonK9k3f4WvVVTd/uz8nUUZl2os8Yalu6H7ffEX8sostdpdRcVrNZB3zoKFgsaPH0/XXHMNlStXjnLnzi3mq5966qkisTJv3rxUpEgROvfcc+nVV1+l33//Xf6XzoLGtMWdzq9hEIstP3yjfRngOnXqyKvYRNuzHdDtz9n+zsPZ/vGBPeNlAjaN61TwbQAwutWkY2P+7PydAw0kDAtvS6qxxHLA9erVE9e6cCsAQNLhWXc+Ie/Mgod206ZNtHTpUjGlT/eKfslSu0N3mvdvf3lnFif+7siViEcse04XNebPzt9ZONs/PlbnD3sORQCAN///UOmMh5jH/J1DGVesBKmzzjpLXulh26rv6fwSb8o7s3xX7CWq0LSNvAsXWPin6W2PyDvz/L5I71bK5cuXjztNNZE9p0p0wh87f2fgbP/4RDv/dPBdAGDN9mfn7xwwLvWmFKuxTPSWlRYZ/97Pn42TN+Y5684n0arLu/Bw6jW30czdN8o7s5xXbIT2HoCzz449tTM7e06FaOfPOAdn+8dGlz37LgDgbH8zwLgSZUc3bdpUZD3r5MeJb8sr8yzINdBIQqCXKFXvDDrzlofknXlWThlD/2letCteAJCdPacCZ/ubAYEWO//YwJ5x2B3G8k0AwNn+ZkBkiagyuwSpfPnyUcOGDeWdHjYtW0wtT3ha3plnU6uFVLPdVfIu2OQvWZYueWUiTVl3mSwxzwoHAj5MmbSSrD0nC2f7x0a9keoE/XGc7R+JsmccOuzZF+pytr8Z1EOcbGOpOw8A/DhxlLxyh/MGjxBvxkEG4/6XvDqJpu/sLUvM0zzHY7Ttp6XyTg9Yn6JChQryLnV7ToR4G7U4fx7zz0TpDKeklQyNecw/E6vOuLYLbNjzAQBn+5sBDaQyrmQbS0cCgMnv0CXVJ8k78+CNGG/GeEMOKhc8/hYtPM69rn+w4iNn3/7Tsed4qDF/dv5Z0akzEx/l/HFAZ7sBAOxYHPLek3C2vxlgTBgbxUOcyhgp1rtPdsnVZNm76XftmeGpgjdjvCHjTTloNLl5IP1Yxfyqi1aw+M/Kj0fLO320bt1anNO151go58/Z/lnRqTMTH6vz12HPOFQg69kAgLP9zaCMK52H+MQTTxQr1enm65Hu5QEo8Ibc7rn3M4KAvLLE/9S7vDc1dTHpT/HT5Hdp//bN8k4PyElp166dLXuORjl/vPlzwl8kOnVm4qNbZ2XTOAPPBgCc7W8GGJed7Ogrr7xSXulj3fxpdOY/7juq78u8QV3GzKcCpcvLEn+CXf5a3fc87eu60dhui/HA8M6SN/SvOnjppZeKBars2rMV9eave7ZLENCpMxMf5fx1DK/grT+6F8tzAQBn+5sBkSUMy26CFMZdS5QoIe/0sfj1wfLKXTA98KpxS6h0/SayxF/kLlCIOg6dSr81niFL3GX1tA9p16+r5J0+rr76ai32rFBT/dBoMpnoajeYxCiddTl/OH7V7W/FU9bN2f5mUN1KOh5idI9efvnl8k4fa2ZMpBa53FmfPprpO66ny9+ZTbUvuUaW+IOTKlanqz5YTEuLvyxL3Gfx0MfklT7Kli0rFqbSYc9oIK3OP7rBDDM62w0mPkpnHc4f9gs7Vkc0ngkArGP+tp0/P7Rx0W1ciCx79OghSzSS8T2XDH1c3rjPx792pkPX7aIW/xvii7nJWNr4ynGLac5fd8oS96m36Qax9bNuMAyFrmhd9szOPys62w0mPladYdO4twPsWL39x8ITLZnOhD+sHZ0rJyfsxCLauOygGkv0AJx22ml0yimnyE/0sfKTsXTW8ea3qE3EhrPmU7fJ34vtc71IofJVqO0z71HnEZ/TZ5u6yVL36VBjMi18+WF5p5cuXbpotWec2flnorPdYOKju33OzvkD1wMA3c4fa0fnOp6TdqJxyvmrBKlu3fQ7myMZ33PWo7fIO+8gds67nejyd+ZQ6fqNZam7nHhSMTp7wAvU45Of6Kdqo11P9otm+bjhtOWHr+WdPho0aEA1atSQd+kRy56Zo7DzN4NuneH0YcuJnD9wPQDQme2vNo7IlYsf4mhgXBi702FcaCyjs6O7du0qGlDd/LZwJtVa01XeeYuvCz5FJz5SnNq9ME6Mt7sBpik27jOAek5fS+vPmE4f/9JJfuIdLij5Fs179l55pxck/9kllj0zR9HZbjDx0d0+J+P8gWsBgO5s/7fO/EA4f147OhJElogqdSXuwLBiZUeXKVOGunfvLu/0MnvIHXRRuTHyznv8WOlt6j51hVhhr8o57Z1fQCjjjbVU3UbU7PbBGY5/DW27cBl9ssGbQRKY90x/OvTnDnmnj+LFi9M119hLzIxnz2FHd7vBxMaJ9jlZ5w9csXqd2f7o9n+76bhjzp/Xjs5EdSvpMC50k+INP1GCVP/+/UX0qZv92zbRghcHyjvvgfFtUP2CzkR9/6NeM9dR22fHUq32V9OJhYuKz+yS87jjqWLTc6n1wFeo9+zfKe+gkmLzIjfX80+GxocG0PIPR8g7vdxyyy1iMap0SMaew4rOdoOJj26dlfNPxZaNBwA6s/3VmP9xGQ8yO/9IlHEhutTh/NUYaaLGsmrVqo4sDAS+e/clanbEe9v1wvljS9v//vmbpv521J4/396Tfqr6Lh3u+Sdd9/kaunTYp6Kb/pRO11Glsy6kErUaUN5ipcQCPdHkLliIilarLbL4a3foRo2uv4cuemYM3bhwG+W6Jzf9etqnNOPPPvKnvc0l1SbSjIduhDHKEn0ULlyYrr/+enmXGsnacxjR2W4w8XGifVZv/qnYM35S69NZZVL87GgnEv5i7Rf9cp1hdFG10vLOPiVLlqTNm/UuXeokVuOyO6akjAtvSsm83f/0009iRoATjUfRanWo64dLaMp6b6wOaXX+6XynC0u/Qwd3baMDO7bS8fkKUoFSZSl3/kI0aU0w9j8vNrUuLXnDmamc9913n+hxSpVU7TlM2G03vv/+e2revLm8s0/1uvXp30HOrsJ51/H/oxsvOlve2QfrUcyePVvexSZVneM5dJQre4bzT8eejfUAmHL+YcdN5w9q1apFnTo5k4i2Y80KmvmIN2YF2HX+4NNN19DsQ3dQ8Zr16aSK1QLl/BtsvZmWDHNmIacCBQrQjTfeKO+Sh51/fHS2G0x8dOsMO07X+QNjAYDObH9k+bPzjw2MC2NKOowLhpVOYzlgwAB5pZ8VE96kGj91lnfuAef/b4Y96+iNyJFhz7mOPyEwzr9N4dfp07uvQWsnS/TSu3dvKlSokLxLnnTtOQzobDeY+Ohun+04f+B4AGDN9tfRICDhT435M5kgskRUqSuhBOOjaow0VerXr08XX3yxvNPPjIduoha5npB3ZsGbf/uqE4TzV2P+dmhXaRzlOi449oytfqfe0YUO7touS/SCpL+bb75Z3iWPHXsOMrrbDSY2TrTPdp0/cPRpsHb7w/lftzj9BDGV7c8Jf1lR3Uo6jAvdpNbGEvfpMGTIEPE7nOCfQwdoSr/LqF3F92WJGVS3vw7n37b8exHO32sL96TLl8/fTxu+mS/v9HPHHXdQsWLF5F326LLnIOJEu8FkRbfO6s1fRzDrWAAQPeZv1/lztn9slHEhutRhXIgodTSWtWvXpn79+sk7/exY82NGEHC5eOM0Qaxs/3SB88+RYc9Bc/7VV1xKXw1zrmcGs0xSsSmd9hw0nGg34JSYSLzaPiscCQCcTPhj55+J1bjsjikp41JjpDqM68EHH6Ry5crJO/38MnsqTb8/valgqaAj4U9xzPnLMf+gOH9s9PP5A87+LZ5++mnKnTu3vEuME/YcFJxqN3S8kQYJJ3SG89dpz9r/YpztbwYnnb8u8uXLR88995y8c4YVH71FRafUkXf6cdL5B4UzDtwremOwd4NTdOjQgVq3bi3vEuOUPQcBP7QbQUCnzgD6KuevE+0BgHL+R47Y6+4AnO0fHxgXxpR0GBe67px6iDt37kznn3++vHMGdDtXWJScc0gVzvZPDJIxJ97Qjv45dFCW6Cdv3rz0+OPJryfgpD37Hb+0G35Ht85OOH+gPQDQ5fw52z82iCwRVepIKAEwLDWm5BQvvfRS0l236YL9AnROD+Rs/+w5O+8LNKHX+XRozy5Z4gz33nsvlS1bVt4lxoQ9+xE/tht+xQmdnQqytP/17Dp/zvaPj+pW0mFc6L6zPsS6xpRiUb16dbr77rvlnUNkaPPZvddS+YXnyIL04Wz/7MGyzGOvbEZ7N/8hS5yhZs2adNNNN8m7+Ji0Z7/h13bDj0BrJ3R2Ck+Fb5ztHx8YFB5iRJc6jAsRpcmHGIsDnXrqqfLOITIevjlD7qBiU0+RBalzSfVJnO2fDafvuZM+uKYl7d/u7PLY6F4eOnSosNNEuGHPfsHv7YbfQACgQ2fV7e+0zp4JADjbPz4wKowl4SG2O6akHmI1dmfqIcYQwAcffCCWcXWaJW8MobyjSojNaFIBb/5H/vuXs/0TcMrvPWlCrwvo8N7dssQ5Bg0alG3Q6JY9+4EgtBt+A5rbAbpax/yd1tkTAQBn+8cHBqUieN0PsWmqVatGw4YNk3fO8sP4kTT5tk5JLxbE2f7ZU3VZe/q4b2f65/AhWeIcWEmyT5/Eux66bc9eJkjtRliIdv4m8EQAwNn+8VFjd3YfYuCFrN0rrriCbrjhBnnnLGtnTqLRnRtRi1zZb0rD2f7xQRCFHpXpA3s7OtVPUaFCBXr11VflXXy8YM9eJWjtRhgw7fyB6wEAZ/vHBhE8oncdCSUAhqXGlNzm+eefF/sFmAArBiIIqLY8tjPmbP/ENM/5uNAPPSomgI2+/fbb2W724yV79hJBbjeCjFs6u/ZX5Wz/+KjuOyeySXHvNnny5BH5APnz55clzoI56p/f34tOeKMAXVRujCzlbP/sQJf/mMvOEEGUKR555BE67bTT5F1WvGjPXiHo7UYQcVtnVwIAzvaPj3XsTsdDjO4kLz7ENWrUoOHDhxv9TiunvkfvdmwoVq6zjvlztn8k5xcfSccPzSe6/J1c4Cea9u3bJ9zpz8v27DZhaTeChBd0Nh4AcLZ/fKwPcRiydpEP8MQTZrf1/fO3NTT2quY0bUBPOrB9C2f7W8AUyCrftaU3LziZVn1idqfFJk2aJEwQ9YM9u0XY2o0g4BWdjQYA1jd/TviLxImHGJElzl7mrrvuElu8GiVD6xUT3qRRl9SnSl9fQBeVHS0/SA3l/HNm6Oz3hL8z/3mI3ruiCc146EbHV/aLBjtHYkgIe/3Hwk/2bJqwtht+xks6Gw0A1Jv/1XM7yhJGgYdYV9YujAqRJbJK/QB2ebv66qvlnTkO7d5Jsx69hcb3PI/O2N9fliaPevOfvMa/9nxBqbepwPsVxFj/5uVfyVJzYLfICRMmUOHChWVJVvxmzyYJc7vhV7yks7EAAAl/cP5ByY7WBSJ4RO+6snZhVDAujCn5BUTEI0eOpAsuuECWmGXTssU0tmsLOvLcETp9z12yNDHtKn4gnL9f7fm8YiPELorDz6lEy8a8Skc02F6qFClShCZOnEhlypSRJVnxoz2bgNsNf+I1nR3/Fuj2f+vMDzjhLwaq+05X1q7VuHDvJ9Ad9uGHH1Ljxo1liWEy/ha/zp4qlrj9Z8hBOnX7rfKDSES2v8X5+23Mv81JQ6nwhGo0vHVlsYviX/v3yk/Mgh3+8PdGMmgs/G7PTsLthv/wqs6OBgDWhD92/pFYx+50Ze36/SHOly8fTZ06VYwJu8lvC2fS+J7n0+GHd1GttVeLbnJgTfjzm/NvnuMxKjC2PI1oU4W+fft5+ufQAfmJebAs9Lvvvkunn366LIkkKPbsBNxu+A8v65wTc7J18tchuUyoqPRxxxL+TDr/vzQvVRovOSldrA+x7sQdvz/ERYsWpblz54qscLfZ8O2XNPWOLvTm+TUo/5iytPWnpccS/vzg/M8t8gaVX9CK9t7zO41qX4+Wvfca/fvXYfmpO2AviPHjx1ObNm1kSSRBs2edcLvhP7yuc87SpUvLSz3s2LpFnHNlvCnB+buR8Ld98yZ5pQedGjn1EKN7KSggCJg5cyZddNFFssRdDv65g75/fyi937UFvd3uFCr9RRNqmfsZ+am3uKD0KDr55y7031N/0xutytOcJ+6kbSuXyU/dpWTJkvTpp5/SWWedJUsiCao964DbDf/hB51zJkrASQc4X+ubvxts37RRXulBp0Z4iHVl7aoxpSA+xBgjnjRpEnXr1k2WeINdv66iL5+/X8yV33bDUsrzZlGq8dNl1LrQa/InzNK2wlhqsO0WKjK5Fu2/bxO91qQYfXrX1bRu/jQj6/YnS5UqVWj69OlUr149WZKVINuzXbjd8B9+0Fl7ALBt44ZjCX9usfn33+SVHnRohAge0buurF1ElTgwphRU8OC89dZbdOedd8oSb7F38x/048S36bP+3WlYxtv2rttWUb53S1GFRa2p/pab6Ox8L4rFdXRxfok3xXRF7GsAh3/4kT/plUYnie15vx7xFG1Z8Y0r2fzZgX0f4PwrVaokS7ISBntOB243/IlfdM5x2223HXnxxRflrX0uuqobDXz9LVcT/kq98i8t+PxTeWefxx9/nPr3T32euEJ13+nM2lXGhfsw8Mwzz4hFg6Clnzgudx4qXKEaFalSk/KVKEMn5Ctw9Mhf8Nj18Xnzi7F5ZOT/tW/P0bM8Dv25g3at+5l2/rpKXPuNVq1a0ZgxY+Lu+xBWe04Gv7Ub33//vdZNvqqdUo/+G1xB3jnDncfdQTe1PUfe2QfDW9OmTfONPefIcG5H7r33Xnlrn4InFaFpv251rfsfMw/Oq1iM/jqsL9kJu5Ol2xWtHmKdY3dezCY1AZLHevbsSbt375YljJe5/vrrRfAMe41F2O05EX5sNzZs2CAWdtJF8TJlqcBrp8o7Z+i1uxvd1+1yeWefjh070rhx43xjzzlLlSolL/WwZ9dO+nb+HHlnnkUzpml1/iDdJECnHmKcw9hYdurUib799tuEu8Ux7oNMfwTN6LVJxvmH1Z7j4dd2A74Ejk8XO7duodGt9A2hRTPm7Mm0dcMf8k4PCID8ZM85K1TQ38Xy9jOPyyuz4A866jn9m8uko5GTD3GYQTLZggUL6JZbbpEljJdAF/D8+fPFm1A82J7j4+d2A/9GiRIl5J19/s3QYf3PK+WdXuAr8PvX/viDLNFD2bJl5ZU/yImV13Tvy77kixnU9z/zDfSMCR/Qj9/oXc8czv/kk0+Wd8mDh1h31i43lkeBFi+99JJYSa5QoUKylHGb3r1704wZM6hy5cqyJDZsz/Hxe7uhO6l89scfySu9wPn/9ddhWjBdX64Y0F1/p8mJVbnOP/98eauPlwfeQ++0mCDvnOfNJu/T6w8PkHf6uOSSS+RVciCCR/TOWbvOAp2xfzzeNk891dlxQiYx6PIfNWqU2NQJ7Uki2J5jE5R2Q/e6Mp+Pe49Gt5wo7+yDN3/4pb///ouWfjmXdnh4zRgTCOtAQ6qb1cuX0VN33CzvnAV/1Idv6E5//LpWlugjlQBAdd/pytq1PsR+GVMygVXnihUriilm999/v/YVG5nswWJNixYtog4dEif9sj3HJ0jthu434F9+WkHvvvi0vLOH6vaH8z+0fz89e3c/+Yk+fNcDgP+78MILRXeRbia+NYw6/nyevHOONwYNpFkTP5R3+jjppJOoZcuW8i4x6iFGFK/jIUa3HTeWWYmlM7o57777bvrqq6+ELTPOg8ALe/iPHTuWypcvL0tjw/Ycn6C1G07s4zFs8IM0uPQQeZceyvn/k6Ez1soY9vhD9Pva1fJTPeAFJLvhL68hAgDsxR1veU67PNf/drp8XTt5p5/zvz2TRj45SN7pBW83yQRG1ofYT1m7fiM7nZGv8f7774vDieRW5uhGPgi2lixZktT2zWzP8Qliu5HqkGkyYFYXenjfPSu9fACr8//vv39p6YJ5NGH46/JTfZx77rm+64U8NkDkxDAA+C/DsIf07UOnfVIp7T9gLN5u9iGd/F5hes2BcX9Fdt2awMmHmMkkFZ3RC4DeACwcBC0ZPZxzzjmiuz/Z4Ra25/gEtd3AG3Ci5Z7TZeV339Cz9/RLOa8s2vmvX71K+CPor5tk/IXXOBYAIHJzYhhAMW7oy3Tjha3ogUIDZUn63JPnburVpil9OvZdWaIfJDYl84aDhxhjd3YfYsDZ0fFJVWc4qAceeEA4rEsvvVR0iTLpUadOHbF978SJE6lq1aqyNHvYnuMT5HbDKUf44Ruv0LWtzqBHSwyWJdmjxvz/+edvev+1l6j3eS1oyx+/y0/1Ae0vvvhieecfjrWKmL/Yq1cveecMyxZ9Sded3ZiqvJ2XHiuT+nz9h4o+QmVfz0E3nH8WrVr6rSx1Brw9JpoeiQgS0buOxB1gTdxhMrGrc7Vq1cR+AugR6Nq1q6NBbtDAgksY48e6C6n2ELI9xyYM7YaTb8I/f7+UerRsJIZ+E80OwJu/yvb/45e11K/jhfT6IwMyt6vXTLNmzahYsWLyzj/kyDDGDJs82h2yZcsWqlWrFu3bt0/cO03F6idTi4vaU9PzLqSylapQ0VKlqdv8TuKzt5uOo+1bNtEfa9fQl59/QvOmTqYN634RnzkNVrRas2YN5cuXT5ZEAr1UBK8jcQdOST3Ebo3deREndN64caOYrjZy5Eg6rHnFyKDQvHlzEQCfffbZsiR52J7jE6Z2Axs/rV+/Xt45A/zHOR06Z/iQi6lyzdrUc8lVovzdjMBg26YN9O28OTTv08m04LOpdOjgQfGZUzz77LN0++23yzv/EBEA4Pzoo4/SoEHOJNUlQ6EiRcX3wJLCbvHaa69Rnz595F0k6iFGFK9z7M5LDzHqtnjxYvrmm2/o66+/Fpt8oIcIb4Q4EO0WL15c/rQzOK3zpk2bxFK1r7/+Ou3fv1/+ZLhBEhMcf5MmTWRJanjJnpcvXy4SFWHDOPCdlP2eccYZaS3uZYcwtBtWBg4cKHyJSU7Ml5/y5s9Pu7ZvE7lnpsiTJ494YfTbKoAgSwCAt39M5UBvQBipUaMGrVixImZXsVMPMc5e4bvvvqNrr72Wli1bJkuygp6RIUOG0M033+xI42NSZ2wshM07sHY9FhUKG1i7/MorrxQHhkvSxSv2vHXrVmGXWCUyEdioCD1BBQsWlCXOEYZ2I5o9e/aIfJHt27fLkuCCoPnJJ5+Ud/4iIgAAMLChQ4eGdq117DiHpLFogv4Qo1sSETscO+qZDJg6OmLECFuOIxo3dV67dq1Y0e6dd96hX3/9VZYGDwRw2FjpqquuEr051uc/Hbxiz++99x7deuuttGNHctsmY6rosGHD6LzznFurJOjtRiKwzXzfvn3lXTApUqSIaDcwld6PRAQAysBgqMj8/fnnn0V5WDjzzDNFwlMs8ADrTtzx0kN8+eWXizfhVEGiJN62dC0n7QWd8TzMnTtXBAOoG95m/A40QMDWvXt34fwxnz8o9ow63HTTTeLFJR2mTJlCbdu2lXd6CXq7kQjUHTllcJBBBcOId9xxh7zzH8cCAIwlWceTli5dKpKBwjI+WrRoUZEpHr2SE7RBBK/7IfbS2B1WdLviiivkXeqgPm+++abIsk8Xr+qM74Qx5FmzZtEXX3xBX375JR04cEB+6l1Q57p164q5+0jmw4qW2DgpaPaMRE70ZEyYkP6+I1i+FcN+Ot/iwtBuJAMW5erSpYu8CxZIdFy5cmW2+194GREAwKBiGRYeqs6dOwtjDjJ4sD7//HNq1aqVLDmKzocY2noxaxdjpujtsTtWh/ogGk4nE9ZPOuM7IkFSBQRYZ8Arswlq1qx5zOHDlqOnJQXNnpG/gfVL5syZI0vSp1u3biIPRAdhaDeSBVogqRQJmUFj9OjRIvj0MzkyDPVIIsPCjAAsqBJkYmX9q4cY3Vg6x+689hAjYerVV1+Vd/bBMrHII0i2jn7XGd8bXZx4E8CxatWqY9d//vmn/Cl9oG7IuYCzx4FsdnVOtDVy0OwZsziwUBdmqOgCTqpRo0byLj3C0m6kwi+//CJmXiSbm+EHkCiNqcR+J0dGhCp6ABKBDGEsCBJEMHb4yiuvyLujOPUQ4+w1sJUuhnt0gnHm4cOHx5xJYSXoOqN3BYEAnBVm1+zduzfiUGU4oxsRq0/iQF6FulYHNqbCDBUMUaVav6DpvHr1apG4t27dOlmih+eff95W0lqY2o1UmT17tphmCn38TtOmTUXvH/42fidHhtFm279/8OBBkUCEOeFBAl2l6Pq3OqowPcToooRzwVk32EgJSYV58+aVJZFwY2mGoOmMNgi2tW3bNlmiDwSuWDUyHdieswdrbtx4443yzp9g5ghyxUqUKCFL/E1S60diXfXJkydTgwYNZIn/QcY/Mryj31LxEMMh2n2IAX63lx9iJD454fzBJ598Qq1bt6adO2Mv6BQmnd0kSDojWEfQ7oTzB1gDI13YnrMHw6zocfUreJmZNGlSYJw/SHoB6dKlS4sMaCQF+p0ePXqILhzM4VQggkf0jofYbuIOQNKOStzxKk7P8ECCHGaS/P575uYbYdTZDYKm85gxY6hdu3aOLlOezvPA9pwaL7zwgtit02/gb4INsYL0EgxSsjJEQJgy9tBDD4luKr+BiBqZ6piyZp26obrvdDzE0MX6EHtZJ2zb6fT3++mnn8Tyq+gRCKvOpgmSzqgDZpZgiikcrZPUr19fXiUH23PqoHcDvclIPvYLmE0zY8YM6tixoywJDimHmTDMBx98UIzvxtssx4sgQxoLfkQv2qAeYjQuOh5iBBl+eYixDGqVKlXknXOgyxZvb2jI8ZYVNp1NEiR7RrIfhuqQnGcCJMQmS5jbDbsgCHj55ZdFTgDq7GUwRRqzQ5ADF0TS7mfCamIYEoheOMeLYDUqzN2O3t/f+hDrTtzxy0OcSqNnB2iN7j+M4dpZGcyvOpsgSPaMVRgbNmxI337r7LbfVpJ9Frjd0MMNN9xA06dP9+w2unhpWbhwoS98XLrYGmhCl9mPP/5ITz31lJim5DWQrPHSSy+JjW2id/9y8iH2E5i3b/I7qxUm05lW6mednSYo9owx/muuuUZk5Ds53h8Ngo1klrPmdkMvWKESb9jo6fEK+Hvcf//9IuEPs6SCTK6HMKBvA3TnYF5k7969RVcYInY8IG6CoYl7771XOJkWLVrEfLjwHXWM3QF0Y/n1IcYWlocOHTK6Ex4az48//lhsuIOV66BdMvhZZ6cJgj1jyWXMFceccZOgrshRQaJzdnC7oR+8PPbs2VMsXY2ZGPFmDjkNAjKs7PfRRx+JDeFwH3SSWgcgFZDxjZUDsaOajockFRCM9OrVS+QolCpVSpZGoiJ4nQ8xDj+P3UELvAFhWqBpsGUo5l5nl4AVBJ2dIAj2jDo899xzImhHPUyD1U4HDBgg72LD7YYZ8HKA3ADsTOrUdM9YIPB84oknjA2JegHYsfYAQIEV0PAGjm4U3SvNWcHDc/rpp4s1wbHpBBxKPHQ+xPh3EXAE5SFGtj4egg0bNsgSc+AtCB1RmCMMLa0ETWedBMGeN2/eLN7+8AbuBtgFE2u6o+7x4HbDDFadsQMnEgWxmZBTuwmi3UEPJBLD0faFBeiMw9EAwMr69etFIDBx4kSaN2+e+CPbAQ8Pksk6dOhA7du3F93Y2aGMS/fYXZAe4t9++02MgyJ4cwP0Ajz99NPUuHFjcR9UnXXgd3vGd8d+8Q8//LBr2y3fcsstIjEVdY4HtxtmSKQz9tdAgDh16lSxEqSdIAzDDVhJEi+MSAoP+hh/NNAZh9LQSABgBeM7yPzEBhFYI33jxo3HDtwj+gN58uQRY3LYqlOdceANH+uAYwpbsiQyrlSxPsQ4Bw1s2IHsVyzi4wbQFz056ALE3zuoOtvB7/Y8c+ZMuu2220QCsVuk0u3P7YazpKIz9teYNm2aCArgL7Zs2SLOar8NgOCqZMmSEX4DB6byIScsUW9PkIHOOOD8cYZNGg8AsgMOCF/MukqfHVA9fohTA/vdX3bZZa51ywIEeMgl6devX2gf2Fj42Z6RH4TuVizB7Rao59ChQ8WwQyK43TCDTp2xZw3aLvXiwEQCx6+cP/BkAKAbGJaOsTuAoQccYXiI8VAioVLXHunpUrt2bTGVE2N1jD/t+fDhw2Jo57HHHhMNtFtgTxPkJWHYMDu43TAD62wGBFfK+cPxg0AHAKgWnJhu4wrb2F3//v1FdqzboEcCyziXL19eloQLv9ozxm2xxa5TiVzJgrFfTD1t1qyZLIkNtxtmYJ3NAedv7V1R+uAcyABAp3FBpLBn7WIpVnTdum0q2IsCCxdh/NiLC085hR/tGeuBDBw4UAQAblOuXDn67LPPxLKuieB2wwyssxmgM/SF88e10sZ6DlwAoIxLx5gSBEJ3EsaTwm5c7733nlidDbq6Tf78+cXwBIKSoPcI+M2ekeD75JNPis1TvACWAUfSWHZ2wu2GGVhnM0Bnq/MHSh/rOVABgFPGhTNztHHHClkml2hNBKL+K6+8ku666y465ZRTZGlw8Is947shsQ9DRXb21NcNlpfFBmDZJRRzu2EG1tkM0Fk5f5yhFYh1DkwAwMZlBszDxUZQWDPAK+Dvhbm9GB4Iyq5dfrBnZF1ja23kZmBar5fAAj/4bhg2SgS3G2Zgnc0AnaEvDlwD6BXvHJgAAIalO6GEjSsr0BlLdGLVPizu5DWaNGkiAgEs9IFuQb/iZXvGWh6vvPKKmJ1hcrnWZECmP3JWsDdJMnC7YQbW2QwIsuD8s3vzV2ffBwD4+qi0buPiMaVIYuk8YsQIsX47NhPyGtWrV6du3bqJRYWqVasmS72PV+0ZjcqsWbNELsgHH3xA+/fvl594ByT5YenY7JL9ALcbZmCdzQCd8YxCa1wDpU+is68DAJ3GBTE4mzQ2iXTGBkLXXnuta8sHJ0OjRo1ErsAVV1whFgnxKl60Z+yHrpw+Vl3zKnjjx5s/egCyg9sNM7DOZoDO0c4fKI0SnX0bAMCgUGl0LeFsBwiB7iSMKbFxRZKMzhgLRiLeqFGjZIk3wd8WOQLY8hN5DLpWm9SBl+z5+++/F04fi+asW7dOlnqTQoUK0bBhw8Q6EcnA7YYZWGczWJ0/NAdKn2TOvgwA8JVRYd3GhTOTSao6jx8/XszR37t3ryzxLniTwMZH6BnA3gep7C2hGy/Y8+rVq8Vb/pgxY1xdoz8VsGkUgpRKlSrJksRwu2EG1tkM0Bn6Qmvl/AE0S/bsuwCAjcsM6eqMN0YMCXzzzTeyxPvgb499wNE70LJlS2revLmx3gG37BmbqcyZM4fmzp0rzn/88Yf8xPugnkj0xIY+6BZOBm43zMA6m0HpjAPOH1op1HUyZ98FADAsHWNKAG+BONi4smJHZ/y32OYVWeI+My8BHoy6deseCwiwgxh2F3MCE/aMv8EPP/xwzOHj8PJ4fiLwd8BQE3YETQVuN8zAOpsBOivnD5RTB7EcfbyzbwIAfE1UWLdxeW1Mafv27WIxFRzolq1Rowaddtpp1LBhQypcuLD8KefQqTOyxm+//Xb69ddfZYl/qVmzpggI6tevL2YY4KhQoYKwn3Rwyp4xIwPr7sN2cGBb53nz5ompe34Hi1C9+uqrKQVjXmg30CuGHjEcu3fvFs8ynmksXpVsD4bXCUv77DZKZwQAuFZYNVLXyZx9EQDoNC5U2ovZpGissbwt3s7igR3xhg8fTpUrV5YlenFCZ/weLBQzZMgQV3eCcwJ0TVapUkUEA5hqqAIDXCcKDuzqjKRLLLwDR48zAixcr1mzhjZu3Ch/KjhgR8gXXniB2rRpI0uSw+12Y/LkyXTLLbeIbZBjkSdPHrrzzjvFttewJb8ShvbZCyido50/sOqkrrM7C30zfpGnAwAYFMaSUGmdY0peMS7U77nnnhONABr27MA6+Nha9YYbbpAlenBaZzSCaOyQaBYGUHfkEeDvVaBAAXFWR758+cSBVepwRhkebCyxjANz7NV1rLJdu3ZlaQCCCDL8H3zwQbr11ltTflN2s93YsWOHSIZFQmUyYN0CrFqI6ap+I+jts1dQzh+H0tmqT6zrRGfoKzT2cgCgKq3buHD2ChdffLFYrzxVsNLdhAkTxB/RLiZ1nj17tmjQMSbNMLGADfXo0UP0GpUoUUKWJo+b7QaGXDp06JByjgV+97vvvisWrvILYWifvYDSGYdVZ2imiHUd66wOaIyzZ9dKdcK40K3kJeN644030nL+AMvwPvvss/IufUzr3KpVK1q6dCm9+OKLRnIaGH+Bt2A40ZEjR3rG+SfbbmDLYQxTpJNgie+K5bX9MoQThvbZC+jUGSitcRb3Gf+AJ3sAUGEdY0oA3YdeiyzXr18vMs3tzJnPnTu3SBbElqfp4qbOWEf+vvvuE429jn+f8S9w9o8//riYQqoap3Rwy57R3Y9eC/z7dmjbtm3aLwUmCXr77BWgM45YOlufk1jX0Wfoi8P6s57rAUA84oRx6egq14mOBXMOHz4s9uhPJzL0gs7FixcXq7gtWbJEbOLDhA/YTb9+/ejnn3+m6667LqJxSgU37Rm9WVdffbX49+0ydepUGjdunLzzHmFpn91G6YxDh85w/NA4+vnylOqoNLo7dBgXKmo1rnQbFieAw545c6a8s8dXX31Fy5cvl3fJ4TWdMSVqwYIFouHDNRN80N2LN2bYLpJgkfCXLm7a8/333099+/YV30EX06ZNk1feIizts9sonXU4f+gKfdURjWcCAN2VRsTjVePCxjk6d1NLZdU9r+qM/7Zz58709ddf04wZM1Ke8sX4A8x4wNoQmL6IzHesr2AHt+wZ/xZm4gwePFiW6APDel4jTO2zm1h1xosi7u0AfdXbfyw8EQBEV9oOyrhUQokXjUv3MrnJ/j6/6Ny6dWuaPn26qNfll18e13gZ/4DhnkcffZR+++03kbxarlw5+Un6uGXPGHrD5kNI4nUCzJBBnbxC2Npnt9Ctc3bOH7jesjplXOhe8iobNmyQV3pIZkqdH3XGimnY3x3jw3jbwsIpjL/AolUvv/yySHpFd/lJJ50kP7GHW/a8Z88euvDCC8UUXKdAFzsSZL1AGNtnN9CpM4DTh8bZvTy5HgCg0jB4HZWGcaFbyevGhSVAdVK+fHl5FR8/61y1alV6/fXXxZKq9957r63xYsYMWDJ59OjRYoXLm2++Oal9+lPBDXveunWrmMb6xRdfyBJnwPTYMmXKyDt3CWP77Aa6dU7G+QPXAgBEPIh2UGm7Y0oAFVZjSl4HO8/pJNHvC5LOWAP+scceE93ITz75JFWsWFF+wngB2ASGbz799FOx1sNVV10lGiOduGXPWG65WbNmRsbnGzRoIK/cI8zts0mc0BlHsjq78tdApVXEY7fS6FZCl5IyLtx7HYx/FitWTN7ZJ16DEVSdsXf/XXfdJRrlL7/8Uqws6NRufUz2YPEejOtjuWckcF5wwQXyE724Zc+ff/45nXHGGWKvBRPofkFIlbC3z6bQqTNQzj8VjY0vBKQqjajHbncHKqq6lfxmXFgABwuf2AXdhegaj+4WD5vOqCO6Zt977z0xPvvnn3/KTxgnwPr1V155pVi6FkM0TuOGPaNRfuSRR0Tyoo4GOhnQgC9evFjkv7gBt89mSEXneLqpcqUzAi3onApGAwCnjAtnv4FMYry5Y0qgHbCKHlZPsxJ2nRFRY1lWBAPYkS1ouxC6BRL64PDh+LGKpSncsGck4XXt2lXMRjHJwIED6eGHH5Z3ZuH22Qyp6gwtY4FypTMCx3R0NhYAsHFlBYvftGjRIu23i3PPPVd0T1phnSPBegsIAsaOHSuCAgQHTPKULl1aTMWE02/cuLEsNYcb9oxhpSuuuEL7bJ3swAsBVsXEm5xpuN0wQzo6Q89YoFx1+6ers7EAABXWNdaBBwRHEIwLXYzY8jRVkEOAVQArVaokS47COscHSy+jcZ8zZ444sOgQ9GIyKVq0KJ111lnUsmVLcUY2f6rdijoxbc/IZbjnnntEI20SrJOAnTJr164tS8zC7YYZ0tE5XgAAje04f+B4AKAiHlQa13b/OWVcQRpTwpsp5rkjuz0ZsN0opsVZE9+sOut8iIM8doehgYULFx4LCDD2iqGZMFGqVKkIh4+xfS/8vU3b8+7du8VQ2kcffSRLzIHZLOjJq1GjhiwxB7cbZrCjcywdobFd5w8cDQBUpRH1oNJ2/imIgAoH1bj27dsn3jzg2OMZSJEiRcTGIxibtGLHuKIJus6JgPNHEKACAgQHQcsfwAwUOHvl8E8++WT5iXcwbc+YsohlqNeuXStLzIGAC2v/ly1bVpaYg9sNM9jV2aolruH0densWACgKg3nr3NMKejGhW5qNEjffvstLVu2TGT5Y1oQxgex7S8eMiuss3NA059++kksZoPVCHHgGtPB0tnz3RRoHJCwV7169YgDzr5ChQryp7yJaXsePny4mEZ66NAhWWKOM888U+z+p2t1xFTgdsMMOnRWeiqddQZZjgQAThkXzkwmrLMZYumM5EK8MUYf2ORm+/bttt+osgN/JzjzaCdfrVo1kRfix7+hSXtGlz+25B41apQsMQuWE/7www8pb968ssQc3G6YQZfO0FjpDOevU2ftAQAblxl06Yyehh07dhwzMryNYGYCIkwmPZ3x3+CNEsM6CBRwxlACrg8ePCg+wxnl6mfQs5MvXz6xW546ou+tZXgmgoTJdgPrRNxyyy20adMmWWIWDOFhJ0Q05qbh9tkMunVWwyu6ddYeAKDCOPAGZPdXo8JOVDoIQON0x5TgcDBHHt2fP/74oyzNBG+WvXr1ouuuu86VsUkvYUfnaNie42NC540bN4p9CSZOnChLzINeh+eff1406m7A9mwGv+isLQDAr1ERj6q0nV+tKs1jSpEondM1LizV2r17d5FrkB0wOPzskCFDxDSlMGFX52jYnmNjQmf8G0OHDhVJttjNzy2woiB2RHQDtmczOKWzU0GWlgBAVdrq/EE6vxrGxNmksbFrXHD+WNAl1aluSEQcPHgw9enTR/xNgo5dna2wPcfHhM5I4uzduzfNnz9f3LsBvs+rr74qpvq6AduzGfyos+0AQFUaR/RYR6q/GpVEpIMxJTauSGBQ0BdBVjpjSuk6fyuYjYCGrEmTJrIkeNjV2Qrbc3yc1hmNMPbawO6RuHYLfCdsi4xphm7A9mwG3TqbCrJsBQCJnD9I5VdbjQtnJhOlc7rGBadfs2ZNkexnF/ydsGBKEIcF7Opshe05Pk7rjCW2r7/++pj5LSZBsibyDbBFshuwPZtBt87K+ZvQOe3+XFQalUXF2bicQ4dxffzxx1qcP8D3wQZEmFOO3gBEvkGAG0szOKkzxveR5Ne8eXPXnT+mY2LZaXb+wUa3ziadP0g7AEBlUWkdDgCVZuOKDYwLXZh2jOutt96SV/rYtWuXaGyxF/yiRYtkqX/RobOC7Tk+TuiM3/XKK68cC0rRKLsJlurGPhP16tWTJeZhezaDbp1NOn+QcgBgjXh0OH9UWI11MJlAZ2gM47KjM/YXmDt3rrzTD9YRaNq0KfXs2VMsgOM3dOmsYHuOjRM6Q+O3335brKGPef2bN2+Wn7oDGvAnn3xS7CdQqFAhWWoWtmczBEXnlP41VBqRDgIAXNsB3R3WSuOeOQq0VZGlXeMy4ZTxfTEsgIYYexW4saxqOujUme05Prp1hqPFYj5169YVgef69evlp+6BTZVmzpxJd911lywxD9uzGYKkc9IBACqtnD8qjft0QSXRzcHGlRVlXIgudTWWpsCwQN++fcU69E8//bRY5c6r6NaZ7Tk2unXGzpmNGzcWq+lhbwYvgI2VvvvuO7G5kluwPZshaDonFQCg0nD+OHRVWo0psXFlYjUuu2NKSufcuXPLEnOgKxZvQliTftCgQWLddS/hhM5sz1nRqTP2yj/nnHPosssuo+XLl8tS97n77rvFmz96ANyC7dkMQdQ522mA+BhOHxW3Vtr6n8X7FdHlqtKIeEy+mfoBaKXbuKDzunXrxCYxboLxUIzR9uvXj4oVKyZL3cEpndmeI9GlMxJMsYLevHnzZIk3gE0juRYJf27C9myGoOqcbQCAyqLiCAKsPxrv2kp0OSrL2aSxgWHpGFMC0Tpj4R7sc+822MgGq6HdeeedVLp0aVlqFid1ZjKxqzMcPtbMnz59uizxDvXr16fx48dT1apVZYl7sD2bIag6JxwCUM4/mxghKRDtoNIY62AygbZOGJdV55tuukleuQs2IXr22WepSpUqYgohZiiYwoTOjD2dkTMybNgwMcbftm1bTzp/LIK1cOFC150/27MZgq5zzB4AFKGyCABwVj9i/dF411ZQrro7VKVxzxwF+iDA0mFciXTGSoDlypXz3DQ9BIXXXHMN3XHHHVSnTh1Zqh9TOoeddHVetWqVcPxjxozxbOIo9u3HDBfMOnAbtmczhEHnLAEAblFZ5fxVmfUM4l1Hw8YVG2gG40J0qWtMKZHOWA0Q65HDmL0IFhTC2xX2K8DmQ7owrXNYSVVn/OzUqVOF43dynQodnHvuuWI3QcxucRu2ZzOEReeIAACXOFBhOH/1UfQZxLtWqEqjywMHkwn00m1cySSUTJ48WWRRezUIAHny5KGOHTuKYADLqOKBSRe3dA4bqei8detWevPNN8WB/fm9TNGiRcWQVbdu3WSJu7A9myFMOkcEANm9+Vt+NO61ApVFpVF5JhNo5aZxIQi4/PLLbe0KaIry5ctT9+7dqUePHimPubqtc1hIRmf8DMbNhw8fTpMmTRI/63XQE/XCCy94ZsMrtmczhE3nYwGAcv64lUVxzyDeNWDnHx8Ylo4xJQCN09EZC6hgWp4Xk6xigQepRYsWolcAPRiYTZAdXtA5DMTTGW0JNsNBwDllyhTPv+0rKlSoQK+99hpddNFFssQbsD2bIWw6iwAAlVUHUA493hnEu1bOn8eUIoFGiCx1G5cdnceNG0e33347bdiwQZZ4H2yxih4MvKFh5TWMq1nxos5BJJbO6FX64osvRL4Jxvd37twpyv0A/r4IigcPHixszCuwPZshrDrnyIjURQAAAXCA7M4g+hqVRKTDxpUV6KPLuKCrziALWdcPPfSQ6O7Ed/QTaKixOtyFF14oDry9eVXnIGG1571799K0adOE08fZy8s/x+OUU04RyYhYL8NLeLndCBJh1jlHRsVFAAAgRDJnYL0G7PxjA51gXOha0jWm5EQ26Q8//CDm5ns9IzsRtWrVEhnbbdq0ETsURvcOJIuTOvsd2POWLVtE1/7EiRPFG79fNn+KBstkDxgwgPr37y/aLi/hl3bD74Rd5xwZFc/QILHDjz4DdY1KorJ4gFB5JhNo5IRxOanzqFGjxDr+yNb2M8gTwCYtCAjOO+88kVCYDKZ09hN//PGHGM/HMX/+fPr+++9t27PbNG/eXLz116xZU5Z4Bz+2G36Edc743nYCAFVpdHmwcUUCffxqXH/++Sfdf//9IhnKbpeYV0BDj2mFp512GtWrV4+qVasmAlcr3FgeTQaGg1cOH4fJFRudpmLFimLIC7NL8Pf2Gn5uN/wE63wUWwEAHD87/9jAsHSMKQH0rrjRw/Ltt9+KYQFsyBI0sLIbAgEcDRo0OHaN8jDZM8bssU+EcvaYrodx/aBRsmRJ0d2PvSjQUHuVILQbfoB1PkraAQAqy84/K9AIkaVu43JzTAnjvQ8++CAtXbpUlgQTOAYkhDVs2JBOPfVUcVZBgd/BNLzVq1eLA9NA1fXKlSttvwF5GawqiS17b7vttqSmj7pFENsNL8I6R5JyAIBKorJw/mxckUAfXcYFXaGxV4wLdZswYYIIBFasWCFLgw8CXHQbYy+FeAfeLvE3chvkbSjHbnX0a9asERsxhQk4+759+4p8Fp1LSztBkNsNL8E6ZyWlAACgsqrSTCbQCMaFriWdY0peMy48OO+//z49/PDDYhMX5uhbQJkyZSKCgrJly1KBAgXE3zD6wM/HK0Ojgm753bt3HzuQk2G9j1W2bds22rNnj/xG4QUa9unTh+677z4RmHmdsLQbbsM6xybpAACVRGVRcRxMJtDHCePyss6o5+jRo+mRRx6htWvXylKGcQc8K0jsQw8V1oPwA2FsN9yAdY5PUgEAgPNX3f5MJtAozMaFur/11ls0aNAgWr9+vSxlGDPgmcHy0AhETz75ZFnqfcLebpiCdU5MUgEAO//4wLB0J5T40bigwYgRI+ixxx4T88YZxknwjHTo0EFk9iNh029wu2EG1jkx2QYAqCwOdv6RQBtElrqNCzoj0vQr0ATJgi+//DLNmzdPljKMHkqUKEHXX3+9GOdHroXf4HbDDKxzciQMAFBZdv5Z0WlcMKagZu1iQRkEAsgVOHDggCxlmNRp3Lix2KwHG0GhC9aPcLthBtY5eWIGAAAVZeefFWVc6FrSOaYU5Id4165d9Oabb9Krr77KCYNM0uTJk4e6dOkiHD9WcPQz3G6YgXVOjZgBACqrDiYTp4wL5zCAaPzTTz8VvQLYOU7ZG8NYwboLN954I/Xq1YuKFi0qS/0LtxtmYJ1TJyIAAKg4O/+ssHHpBQvUoEcAPQOYx86EGzwT2MURS09ffPHFgWl/uN0wA+ucHhEBgKo4zkwkMCzdCSX8EJPIDZgyZQphcaFPPvnEt1vLMulRunRpMa6PN34/TeNLFm43zMA6p8exAEC99bPzj0RFlrqNi7WOBDojVwB7zH/44Yc0c+ZMoTkTPNDFf+mll1KnTp2oadOmgXwOuN0wA+tsDxEAoKJsWFnRaVzQlrN2YxNLZwwLoGdg/PjxNHv2bPE5419q1KghHD4Ovyf0ZQe3G2Zgne2TI0PAI2xYWVHGha4lnWNKrHUkyei8c+dOsSMh1hfA2gJ2/x6MGerWrXvM6WOXxTDA7YYZWGc95MiInEQPAJOJU8YVhjGlVEhHZ+x4h1yBOXPmiGP79u3yE8YLNGrUSDh8dPFXr15dloYDbjfMwDrrI0eGmDwXywIblxl06Izf8eOPP9LcuXNFMPDll1/yjALDlCpVSozjt2zZUizN65eNeHTD7YYZWGe9cAAQBQxLd0IJP8RZcUJn8M0334gEwlmzZomA4ODBg6KcsQ8azNq1a1Pz5s2pWbNm4qhSpYr8NNxwu2EG1lkvHABIVGSp27h47C4SkzofPnyYFi5cKIKB+fPn07Jly0Q+AZMcefPmpdNPP52aNGlyzOEXKVKE7dkCtxtmYJ2dgQOADHQaF4yJs3Zj4wWdsVMhAgHrgUWJdDQqfqdMmTLC2ePA2vtI4oO+bM+x4XbDDKyzc4Q+AFDGpXtMiY0rEi/rjMWIli9fHhEUYCOjvXv3yp8IDsWLFxfd9jgqV65MVatWPXZ/0kknyZ86CttzfLjdMAPr7CyhDgCcMi6cmUz8qDO+M3oLrMeGDRsi7jdu3Cjq5CWgD97klVNXjl5d58+fX/5kYtie48PthhlYZ+cJbQDAxmWGIOuMumFaojU4QFCwb98+0auAA0mIsc7Wa2iDumHMHQ66QIECEedkyvLly0cFCxaksmXLiu5NO7A9x4fbDTOwzmYIbQAAw9KdUMLGlRXWOXvQwKGRQrdkurDOZmCdzcA6myF0AYCKLHUbF48pRcI6m4F1NgPrbAbW2RzQN1QBgE7jgjFxNmlsWGczsM5mYJ3NwDqbATrjgMah2fRfGRe6lnQYF7qT2LiywjqbgXU2A+tsBtbZDNAZh9I4FD0AVuPihBLnYJ3NwDqbgXU2A+tsBuiMA84fZ2gV+B4ANi4zsM5mYJ3NwDqbgXU2B7RWzl8R+AAAxoUxJbvGBTCmxMYVG9bZDKyzGVhnM7DOZoC+OKKHVwIbACDKQVQJ47I7pgQwnqTGlJhMWGczsM5mYJ3NwDqbQzl/aB5NIHMAUCUVWdo1LnQrIbJUxoV75iissxlYZzOwzmZgnc0AnaGvcv5KG+s5cOGSMi5ElzqMC91JbFxZYZ3NwDqbgXU2A+tsBugMfeO9+SsCFQBYjQsVt4MyLjWmxMaVCetsBtbZDKyzGVhnM0Bn5fyzC7ICEwA4aVxMJqyzGVhnM7DOZmCdzQCdoS+0TqaHJTABACqMMSW7xgUwpsTGFRvW2QyssxlYZzOwzmaAvjiSHV7xfQCAiAdRJYwr2UonAuNJakyJyYR1NgPrbAbW2QyssxmgM4IsHKno7GsVVaV1GBe6lazGhXvmKKyzGVhnM7DOZmCdzQCd8dYPrXGdCr4NAGBQqDCiSx3Ghe4kNq6ssM5mYJ3NwDqbgXU2g9X5Q+dQBACq0jAunO2gjEuNKbFxZcI6m4F1NgPrbAbW2QxKZ+X808F3AQAqrSJL3cbFZMI6m4F1NgPrbAbW2Qy6dPZdAIBKY0zJrnEBziaND+tsBtbZDKyzGVhnM0BnHHaHV3wTACDiQbQD47JbaYDxJDWmxGTCOpuBdTYD62wG1tkMSmccOnT2hbqotIos7VYa3UpW48I9cxTW2QyssxlYZzOwzmZQOsP549ou0NbzAQAMSlVah3GhO4mNKyussxlYZzOwzmZgnc2gnD8O6Gw3AIC+4pD3ngSVxFgSjMvumJIyLjWmxMaVCetsBtbZDKyzGVhnM0Bn5fx16IxDBVieDQBUpXUaFyJLnJlMWGczsM5mYJ3NwDqbQafOQGmNM/BsAIBKY0xJR6VRYUSWyCplImGdzcA6m4F1NgPrbAboDOdvd3gF4K0fWivnDzwXACDiQYVhXDoqDaOCcaHyTCassxlYZzOwzmZgnc2gdMahQ2c4fmhsdf7AU6qj0iqytFtpVNRqXNEVDzOssxlYZzOwzmZgnc2gdNbh/KEr9FVHNJ4JAHRXWnUrsXFFwjqbgXU2A+tsBtbZDFadMbyCeztAX2iNcyw8EQBEV9oOyrhUQgkbVyassxlYZzOwzmZgnc2gW+fsnD9wPQBwyrjQvcRkwjqbgXU2A+tsBtbZDDp1BnD60DiR8weuBwCoNMaUdFQaxoVuJTaurLDOZmCdzcA6m4F1NoNunaFxds4fuBYAIOJBtINK2x1TAqgwjCuZSocJ1tkMrLMZWGczsM5mcEJnHMnqnCPjC9hfVDhF8E+qiMdupdGthAqjWwmVxj1zFNbZDKyzGVhnM7DOZkhW53iaWcuVzjhwnazOxsMxVWlEPTqMC90dbFxZYZ3NwDqbgXU2A+tsBid0hvNPVWejPQDWStsd61CVRrcSzkwmrLMZWGczsM5mYJ3NkKrO0DIWKFc6w/mno7OxHgA2LjOwzmZgnc3AOpuBdTaDTp0B9E3X+QNjAQAqjbEOHZVGhdm4YsM6m4F1NgPrbAbW2Qy6dcZhR2fHAwBEPIh2UGlc2wXjSWpMicnEqrPdMSXAOseGdTYD62wG1tkMTuhs1/kDR3MA8KsR8aDiqLSdfwrdSqiwMi7cM0dROuswLtY5PqyzGVhnM7DOZrCrs1VLXMPp69LZsTBNVRrOH90duE8X3ZUOEladdTzErHNsWGczsM5mYJ3N4HWdHekBsFba7liHqjSPKWWFdTYD62wG1tkMrLMZdOkMjZXOcP46ddbeA8DGZQbW2QyssxlYZzOwzmbQqTOAvrqdP9AeAKhK2+3uABhTYuOKDXTGmJIO42Kd48M6m4F1NgPrbAbdOjvh/IG2AAARDxy/1fkjQkwXVFiNdTCZKJ1hXDqCLNY5NqyzGVhnM7DOZnBKZ6eCLC1/PVQaEQ8qbrfSCBqsxmUniAgaSmcYF67twDrHh3U2A+tsBtbZDE7q7BS2kwBVpXHE6+5I9p9ApVV3BxtXJAisoC+CLLvdSqxzfFhnM7DOZmCdzeBXnW2FFsk4/2SxVhrdHWxcmUBnJ4yLdY6EdTYD62wG1tkMftY57QBAVRrOH9FPoi+Kz7L73FppJhPoDI2dMC4mE9bZDKyzGVhnM/hd57QDAFQWlYbzTxZUEEc0bFzx0WVcgHWOD+tsBtbZDKyzGfyuc8o5APhxVBYVh/OP/s9T/HXHKs1jSpFAR2VcqQRZ8WCdY8M6m4F1NgPrbAandDYdZKXUA4BKW52/Xdi4YsMPsRlYZzOwzmZgnc3gpM6mSfpfRKVRWQQAiSqdjKHgZ9i4YqOMC4dd42Kd48M6m4F1NgPrbIag6ZzUEAB+BJW1Vtr6n8X7FbHKUUl0c6DSPKYUCfRSxmV3TIl1jg/rbAbW2QyssxmCqHNSPQBw+qhwvIgHlYkFyq2fsXHFhx9iM7DOZmCdzcA6myGoOmcbAKCyOOD88cUV1msQfW8Fn3mp0l4EGuswLsA6x4d1NgPrbAbW2QxB1TnhEAAqiwM/on7M+uOx/tN4vw5jHTjYuCKBXtBYZ0IJDh67i4R1NgPrbAbW2QxB1zlmAIAiVXFVaeuPxbu2ospRSTh9Nq6sKI11GBfrHB/W2QyssxlYZzOEQecsAQBuVcXVtSLeNYi+B6gkKotKo/JMJtALGuvoVrIaF+scCetsBtbZDKyzGcKic5YAAJGOOhTWH4l3rVBlqDQ7/9hAI2VcOiJL1jk2rLMZWGczsM5mCJPOEUmAqCwOCIAvnh2xfgZlOFBZNq6s8ENsBtbZDKyzGVhnM4RN52MBACqujmhQEQWuE90DVJaNKza6jAtAX87ajQ3rbAbW2QyssxnCprMYAoDTR4VxBuoM4l2D6HuAyuJA5MNkAq1gXDh0GReCLNY5EtbZDKyzGVhnM4RV55yoeHSFo9/wFdFv+ta3f5xRaRxsXJEojWFcuLaD0pkf4qywzmZgnc3AOpshzDrnyKh0Rp2PVjq68tb7RJ8BVBYVZ+OKBDop48LZDjAu1jk2rLMZWGczsM5mCLvOEQEAsF6DRJ8pUFl1MJlAL36InYd1NgPrbAbW2Qysc8b3zqh8hg7xnT5IdI/KqoOJBIaFI1q/dPCjcZmCdTYD62wG1tkMrLMMAHARLUIy96rSiH6YSHQalzIsfoizwjqbgXU2A+tsBtb5KMcCABAtRqJ7VWF2/llR3Uo6jAsaw8BY56ywzmZgnc3AOpuBdc4kIgAA0aLEEgmVRcXZuCKBVjh0GBe0xcEPcVZYZzOwzmZgnc3AOmclSwAAYomjylBZdv5ZUcaF6NKucQFozDpnhXU2A+tsBtbZDKxzbGIGACCWSKisOphMdBqX0pcf4qywzmZgnc3AOpuBdY5PjgxRMjSJL4r6TFU8CJXWjTIsu8YFgmRcumGdzcA6m4F1NgPrHJ8suwEyDMMwDBN0iP4PaawfjpXR+zAAAAAASUVORK5CYII=" />
  
  <title>ESP8266 - DsA Tiny Video Remote Control over WiFi v1.0</title>
  <link rel="stylesheet" href="https://stackpath.bootstrapcdn.com/bootstrap/4.4.1/css/bootstrap.min.css" integrity="sha384-Vkoo8x4CGsO3+Hhxv8T/Q5PaXtkKtu6ug5TOeNV6gBiFeWPGFN9MuhOf23Q9Ifjh" crossorigin="anonymous">
  <link rel="stylesheet" href="https://use.fontawesome.com/releases/v5.7.2/css/all.css" integrity="sha384-fnmOCqbTlWIlj8LyTjo7mOUStjsKC4pOpQbqyi7RrhN7udi9RwhKkMHpvLbHG9Sr" crossorigin="anonymous" />
  <style>
    #mainNav { opacity: 0.9; }
    header { padding: 4em 0 .5em; }
    section { border-top: 1px solid gray; border-bottom: 1px solid gray; }
    .esp-section { color: red; }
    .dht-labels { font-size: 1.5rem; }
    .btn-lights { font-size: 1.2em; }
    .light-on { color: orange; font-size: 2.8em; }
    .light-off { color: black; font-size: 2.6em; }
    input[type=range].vslider { 
        transform: rotate(270deg) translateY(-50%);
        margin-top: 5em;
        margin-bottom: 5em;
        width: 10em;
        height: auto;
    }
  </style>
</head>
<body id="page-top">
  <!-- Navigation -->
  <nav class="navbar navbar-expand-lg navbar-dark bg-dark fixed-top" id="mainNav">
    <div class="container">
      <span class="nav-link navbar-brand" style="cursor: wait /* pointer */; " onclick="window.location.reload();">
       <svg version="1.0" xmlns="http://www.w3.org/2000/svg" viewBox="0 0 514 514" width="50" height="50">
       <metadata> DsA - IoT - 2020 </metadata>
       <g transform="translate(2,512) scale(0.1,-0.1)" fill="lightgreen" stroke="none">
        <path d="M1991 4355 c-392 -64 -716 -221 -989 -482 -57 -54 -62 -62 -62 -102 0 -56 41 -101 93 -101 
              37 0 56 12 157 105 68 61 208 157 310 212 260 141 601 211 889 183 231 -22 422 -78 632 
              -187 104 -53 132 -64 157 -59 66 15 100 94 64 152 -26 41 -267 160 -422 208 -203 64 
              -290 77 -530 81 -151 3 -240 0 -299 -10z"/>
        <path d="M2115 3883 c-299 -37 -604 -179 -780 -364 -46 -48 -55 -63 -55 -94 0 -52 44 -95 98 -95 34 
              0 49 8 108 61 267 236 612 339 950 284 223 -36 403 -121 587 -278 67 -57 85 -67 116 
              -67 44 0 86 33 97 75 10 42 -17 86 -95 153 -204 176 -431 279 -696 317 -92 13 -257 17 
              -330 8z"/>
        <path d="M3414 3836 c-38 -38 -43 -72 -17 -116 52 -89 183 -49 183 55 0 39 -59 95 -100 95 -23 0 -41 
                -9 -66 -34z"/>
        <path d="M313 3519 c-114 -15 -229 -102 -279 -212 l-29 -62 -3 -668 c-3 -747 -3 -746 65 -845 115 -168 
              340 -211 510 -96 61 42 94 83 131 162 l27 57 0 690 0 690 -23 57 c-64 159 -225 250 -399 
              227z m139 -215 c35 -18 65 -58 79 -103 7 -24 9 -250 7 -677 l-3 -640 -25 -37 c-29 -43 
              -91 -77 -142 -77 -55 0 -118 39 -145 90 l-23 44 2 656 3 657 28 36 c54 72 138 91 219 51z"/>
        <path d="M3857 3509 c-140 -33 -238 -151 -245 -296 -7 -124 41 -220 141 -286 63 -41 123 -57 216 -57 l71 
              0 0 -512 c0 -345 4 -526 11 -553 18 -63 75 -140 132 -178 199 -130 452 -22 497 212 6 32 10 
              253 10 542 l0 489 80 0 c44 0 82 0 85 0 3 0 31 12 62 26 72 31 145 101 175 168 31 69 31 190 
              1 257 -24 55 -81 120 -129 150 -75 46 -109 49 -604 48 -256 -1 -482 -5 -503 -10z m1000 -210
              c82 -51 83 -159 0 -209 -27 -17 -51 -20 -160 -20 -133 0 -159 -6 -189 -44 -16 -19 -18 -66 
              -18 -584 0 -506 -2 -568 -17 -599 -37 -79 -135 -96 -197 -34 l-31 31 -5 585 -5 585 -28 27 
              c-27 27 -30 28 -175 33 -102 4 -154 10 -168 19 -32 21 -54 65 -54 108 0 45 20 77 64 104 29 
              18 56 19 490 19 448 0 459 0 493 -21z"/>
        <path d="M2091 3385 c-170 -39 -297 -104 -412 -213 -124 -116 -206 -254 -250 -417 -30 -112 -30 -306 0 
              -419 81 -305 323 -543 626 -617 123 -30 296 -30 410 0 306 81 535 310 621 621 14 49 18 101 
              18 210 0 129 -3 155 -28 235 -52 172 -149 318 -284 426 -81 65 -223 139 -317 164 -85 23 
              -302 29 -384 10z m323 -205 c120 -30 209 -82 302 -175 138 -137 201 -300 191 -495 -9 -168 
              -69 -301 -192 -425 -122 -123 -279 -188 -455 -189 -116 0 -181 14 -285 64 -139 67 -238 166 
              -305 305 -51 108 -65 171 -64 295 2 131 32 234 102 341 154 235 438 348 706 279z"/>
        <path d="M2198 2910 c-116 -20 -222 -100 -275 -208 -25 -50 -28 -68 -28 -152 0 -87 3 -101 32 -161 159 
              -323 636 -252 693 103 38 243 -180 459 -422 418z m144 -216 c45 -23 80 -86 80 -142 0 -142 
              -155 -223 -267 -138 -59 46 -84 141 -51 204 47 90 148 122 238 76z"/>
        <path d="M1340 1759 c-65 -26 -80 -105 -30 -162 65 -74 227 -190 359 -257 308 -155 734 -175 1059 -50 201 77 
              440 238 495 334 43 75 -34 168 -115 137 -14 -5 -54 -35 -88 -66 -168 -149 -384 -249 -604 
              -280 -73 -10 -263 -8 -337 4 -210 34 -405 124 -564 262 -103 88 -124 98 -175 78z"/>
        <path d="M1013 1422 c-70 -10 -99 -114 -45 -164 36 -33 68 -40 109 -23 39 16 67 71 57 110 -13 51 -67 85 -121 77z"/>
        <path d="M3445 1415 c-16 -8 -66 -46 -110 -85 -428 -381 -1046 -507 -1591 -325 -107 36 -238 96 -321 146 -41 25 
              -85 44 -110 47 -37 4 -46 1 -73 -26 -45 -45 -42 -93 8 -141 39 -38 230 -140 342 -184 444 -175 957 
              -165 1396 26 188 81 376 206 522 344 64 61 72 72 72 105 0 27 -8 46 -27 67 -34 36 -69 44 -108 26z"/>
      </g>
      </svg>
      </span>
      <a class="navbar-brand js-scroll-trigger" href="#page-top">DsA Tiny Remote Control</a>
      <button class="navbar-toggler" type="button" data-toggle="collapse" data-target="#navbarResponsive" aria-controls="navbarResponsive" aria-expanded="false" aria-label="Toggle navigation">
        <span class="navbar-toggler-icon"></span>
      </button>
      <div class="collapse navbar-collapse" id="navbarResponsive">
        <ul class="navbar-nav ml-auto">
          <li class="nav-item">
            <a class="nav-link js-scroll-trigger" href="#ambient">Ambient</a>
          </li>
      <li class="nav-item">
            <a class="nav-link js-scroll-trigger" href="#lights">Lights</a>
          </li>
      <li class="nav-item">
            <a class="nav-link js-scroll-trigger" href="#video">Video</a>
          </li>
      <li class="nav-item">
            <a class="nav-link js-scroll-trigger" href="#driving">Driving</a>
          </li>
      <li class="nav-item">
            <a class="nav-link js-scroll-trigger" href="#about">About</a>
          </li>
          <li class="nav-item">
            <a class="nav-link js-scroll-trigger" href="#services">Services</a>
          </li>
          <li class="nav-item">
            <a class="nav-link js-scroll-trigger" href="#contact">Contact</a>
          </li>
          <li class="nav-item">
            <a class="nav-link js-scroll-trigger" href="#reset">Reset WiFi</a>
          </li>
        </ul>
      </div>
    </div>
  </nav>

  <header>
    <div class="container text-center">
      <br />
      <h1>Internet of Things</h1>
    <p class="lead">ESP8266 - DsA Tiny Video Remote Control over WiFi - v1.0</p>
    </div>
  </header>
  
  <section id="ambient" class="bg-light">
    <div class="container text-center" id="dht-container">
      <h2>Ambient</h2>
    <p class="lead">Temperature and Humidity near device</p>
    <div class="row">
    <div class="col-sm">
      <span class="dht-labels">Temperature: </span>
      <span id="temp" class="dht-labels">%TEMPERATURE%</span>
      <span class="dht-labels"> &deg;C </span>
      <i class="fas fa-thermometer-half dht-labels" style="color: #059e8a;"></i>
    </div>
      </div>
    <div class="row">
    <div class="col-sm">
      <span class="dht-labels">Humidity: </span>
      <span id="humid" class="dht-labels">%HUMIDITY%</span>
      <span class="dht-labels"> % </span>
      <i class="fas fa-tint dht-labels" style="color: #00add6;"></i>
    </div>
      </div>
    </div>
  </section>
  
  <section id="lights">
    <div class="container text-center" id="lights-container">
      <h2>Lights Control</h2>
    <p class="lead">Turn On or Off the lights using the buttons.</p>
     <ul>
      <li>Lights can be used also in tandem with Camera for improved video feed.</li>
    <li>The Lights Control can drive also relays (Solid State type recommended) for high power lights/devices.</li>
     </ul>
    <!-- code for Light1 -->
      <div class="row justify-content-center">
       <div class="col-auto">
         <i id="light1icon" class="fas fa-lightbulb light-off"></i>
       </div>
       <div class="col-auto align-self-center"> <-- Light 1 --> </div>
       <div class="col-auto">
         <input type="button" class="btn btn-primary btn-lights" id="light1button" value="Off">
       </div>
      </div>
      <br />
      <!-- code for Light2 -->
      <div class="row justify-content-center">
       <div class="col-auto">
         <i id="light2icon" class="fas fa-lightbulb light-off"></i>
       </div>
       <div class="col-auto align-self-center"> <-- Light 2 --> </div>
       <div class="col-auto">
         <input type="button" class="btn btn-primary btn-lights" id="light2button" value="Off">
       </div>
      </div>
      <br />
      <!-- add more Lights here -->
    </div>
  </section>
  
  <section id="video" class="bg-dark text-light">
    <div class="container text-center" id="video-container">
      <h2>Video Feed</h2>
      <p class="lead">Watch the feed from the (remote/onboard) Camera.</p>
      <!-- code needs improvement -->
            <div class="row justify-content-center">
                  <div class="col-auto">
                        <img class="img-fluid" alt="video" src="http://192.168.0.45:8080/video" />
                  </div>
            </div>
      <p class="lead">You may access the settings for Camera feed here: <br />
      <b><a href="http://192.168.0.45:8080/" target="_blank">http://192.168.0.45:8080/</a></b></p>
    </div>
  </section>

  <section id="driving">
    <div class="container text-center" id="driving-container">
    <h1>Motors Control</h1>
    <h2>Classic RC Transmitter style</h2>
    <p class="lead">Each slider control a motor, left & right, used for driving and steering.</p>
    <p> Unlike standard RC Transmitter modes this is a dual self-centering stick mode.</p>
      <div class="row justify-content-center">
        <div class="col-auto" id="sliders">
          <input type="range" min="-256" max="256" step="16" value="0" list="sliderssteps" class="vslider" id="LSlider" />
          <input type="range" min="-256" max="256" step="16" value="0" list="sliderssteps" class="vslider" id="RSlider" />
             <datalist id="sliderssteps">
                <option>-256</option>
                <option>-128</option>
                <option>-96</option>
                <option>-64</option>
                <option>-32</option>
                <option>0</option>
                <option>32</option>
                <option>64</option>
                <option>96</option>
                <option>128</option>
                <option>256</option>
             </datalist>
        </div>
      </div>
      <div class="row justify-content-center">
        <div class="col">Left: <span id="LOutput"></span></div>
        <div class="col">Right: <span id="ROutput"></span></div>
      </div>
      <h2>GamePad style control</h2>
      <p class="lead">Use arrows to control the motors with predefined values (drive & heading mode).</p>
      <p>There is no speed control using this style. Only half of speed is used for steering with motors</p>
      <div class="row justify-content-center">
        <div class="col-sm-4" id="gamepad">
         <!-- code needs improvement for touches -->
          <svg viewBox="0 0 100 100">
            <circle cx="50" cy="50" r="47" fill="#aaaaaa" stroke="black" stroke-width="1.5px" />
            <circle cx="50" cy="50" r="44" fill="#bbbbbb" />
            <circle cx="50" cy="50" r="20" fill="#cccccc" stroke="black" stroke-width="1px" onclick="/* alert('CENTER'); */" />
      
            <path id="drive-N"  d="m50,14 l4,8 l-8,0 l4,-8z" fill="rgba(0,0,0,0.8)" />
            <path id="drive-NE" d="m72,24 l4,8 l-8,0 l4,-8z" fill="rgba(0,0,0,0.8)" transform="rotate(45 72,28)" />
            <path id="drive-E"  d="m86,50 l-8,4 l0,-8 l8,4z" fill="rgba(0,0,0,0.8)" />
            <path id="drive-SE" d="m72,68 l4,8 l-8,0 l4,-8z" fill="rgba(0,0,0,0.8)" transform="rotate(135 72,72)" />
            <path id="drive-S"  d="m50,86 l4,-8 l-8,0 l4,8z" fill="rgba(0,0,0,0.8)" />
            <path id="drive-SW" d="m26,67 l4,8 l-8,0 l4,-8z" fill="rgba(0,0,0,0.8)" transform="rotate(225 26,71)" />
            <path id="drive-W"  d="m14,50 l8,4 l0,-8 l-8,4z" fill="rgba(0,0,0,0.8)" />
            <path id="drive-NW" d="m27,24 l4,8 l-8,0 l4,-8z" fill="rgba(0,0,0,0.8)" transform="rotate(315 27,28)" />
          </svg>
        </div>
        <br />
      </div>
    </div>
  </section>
  
  <section id="about">
    <div class="container">
      <div class="row">
        <div class="col-lg-8 mx-auto">
          <h2>About this project</h2>
          <p class="lead">DsA Tiny Video Remote Control over WiFi v1.0 is an ESP8266 v3 device project used as IoT either for home surveillance, rc car/robot/rover or any other platform of your choice. Just use your imagination since the main features of this project are: </p>
          <ul>
            <li>ESP8266 WiFi device host name</li>
            <li>Date and Time</li>
            <li>Temperature and Humidity</li>
            <li>Lights/LED Control</li>
            <li>Video by IP Camera (using an old Android Phone/Tablet or another WiFi Camera)
             <ul>
              <li>For Android Phone/Tablet you can use IP Camera app (Google Play Store)</li>
              <li>For WiFi Camera (or IP Camera) choose a model runing WiFi in Access Point mode</li>
             </ul>
            </li>
            <li>Servo control (servo can be used for Camera/Phone for panoramic/tilt views)</li>
            <li>2 x DC Motor control (can be used for car/robot/rover movement</li>
            <li>HTML5, Bootstrap, JavaScript, Ajax/Json, and other stuff...</li>
          </ul>
        </div>
      </div>
    </div>
  </section>

  <section id="services" class="bg-light">
    <div class="container">
      <div class="row">
        <div class="col-lg-8 mx-auto">
          <h2>DsA Services</h2>
          <p class="lead">Mainly I'm offering consulting services regarding websites (e-commerce, presentation) that use Wordpress, OpenCart, HTML, PHP, etc. However, since I'm a technical person with mechanics and electronics knowledge, I can assist in RC Models and/or Home Automation projects</p>
        </div>
      </div>
    </div>
  </section>

  <section id="contact">
    <div class="container">
      <div class="row">
        <div class="col-lg-8 mx-auto">
          <h2>Contact me</h2>
          <p class="lead">Until this section is improved, you may contact me through website: <a href="https://www.dsadm.ro/" target="_blank">www.dsadm.ro</a>. <br /> Thanks ;-) </p>
        </div>
      </div>
    </div>
  </section>

  <section id="reset" class="bg-light">
    <div class="container">
      <div class="row">
        <div class="col-lg-8 mx-auto">
          <h2>Reset WiFi Settings</h2>
          <p class="lead">If you click "Reset WiFi" button, device will reboot and erase current WiFi settings. </p>
          <p>Once the device light is flashing, you need to use a laptop/phone/tablet to connect via WiFi to device Access Point named: </p>
          <p class="lead"><big>DsA-Tiny-RC</big></p>
          <p>After you connect to device, select/click to "sign in to network" or use a browser to connect to it's default IP address <big><b>192.168.4.1</b></big></p>
          <p>Select to connect the device to your WiFi network and make sure is the same WiFi network you're connecting your laptop/phone/tablet.</p>
          <p>Once the WiFi settings (SSID and Password) are saved, the device is connecting automatically to the selected WiFi network.</p>
          <p>The laptop/phone/tablet used in this process can re-connect to the original WiFi network. 
          <br />If same WiFi network as device is used, you may access the IP Address of device.</p>
          <p>If mDNS service is enabled on device, you may access the URL by name: <a href="http://dsatinyremotecontrol.local/">http://dsatinyremotecontrol.local/</a></p>
          <p>Hope you're going to enjoy.
          <br /> Have fun ;-) </p>
          <br />
          <input type="button" class="btn btn-primary btn-lights" id="ResetWiFiButton" onclick="return confirm('WiFi settings deleted!!!')" value="Reset WiFi">
        </div>
      </div>
    </div>
  </section>

  <!-- Footer -->
  <footer class="py-1 bg-dark">
    <div class="container">
      <p class="m-0 text-center text-white">Copyright &copy; DsA 2020</p>
    </div>
    <!-- /.container -->
  </footer>

  <!-- Bootstrap core JavaScript -->
  <script src="https://code.jquery.com/jquery-3.4.1.min.js"></script>
  <script src="https://stackpath.bootstrapcdn.com/bootstrap/4.4.1/js/bootstrap.min.js"></script>
  
  <!-- Plugin JavaScript -->
  <script src="https://cdnjs.cloudflare.com/ajax/libs/jquery-easing/1.4.1/jquery.easing.min.js"></script>

  <!-- Custom JavaScript for html theme -->
  <script>
  (function($) {
  "use strict"; // Start of use strict

  // Smooth scrolling using jQuery easing
  $('a.js-scroll-trigger[href*="#"]:not([href="#"])').click(function() {
    if (location.pathname.replace(/^\//, '') == this.pathname.replace(/^\//, '') && location.hostname == this.hostname) {
      var target = $(this.hash);
      target = target.length ? target : $('[name=' + this.hash.slice(1) + ']');
      if (target.length) {
        $('html, body').animate({
          scrollTop: (target.offset().top - 56)
        }, 1000, "easeInOutExpo");
      return false;
      }
    }
  });

  // Closes responsive menu when a scroll trigger link is clicked
  $('.js-scroll-trigger').click(function() {
    $('.navbar-collapse').collapse('hide');
  });

  // Activate scrollspy to add active class to navbar items on scroll
  $('body').scrollspy({
    target: '#mainNav',
    offset: 56
  });

  })(jQuery); // End of use strict
  </script>

</body>
<script>
/* start of Ajax with XMLHttp for DHT sensor */
setInterval(function () {
  var xhttp = new XMLHttpRequest();
  xhttp.onreadystatechange = function() {
    if (this.readyState == 4 && this.status == 200) {
      document.getElementById("temp").innerHTML = this.responseText;
    }
  };
  xhttp.open("GET", "/temperature", true);
  xhttp.send();
}, 10000 ) ;

setInterval(function () {
  var xhttp = new XMLHttpRequest();
  xhttp.onreadystatechange = function() {
    if (this.readyState == 4 && this.status == 200) {
      document.getElementById("humid").innerHTML = this.responseText;
    }
  };
  xhttp.open("GET", "/humidity", true);
  xhttp.send();
}, 10000 ) ;
</script>
<script>
/* start of JSON with Ajax for POSTvars */
    $(document).ready(function(){
        
        /* start code for Light1 */
        /* change only light1button, light1icon and light1state */
        $("#light1button").click(function(){
            var current_state = $("#light1icon").hasClass("light-off");
                
            if(current_state == true)
            {
                var obj = {light1state: "On"};
                $.ajax({
                  url:"/postvars",
                  type: "POST",
                  data: JSON.stringify(obj),
                  contentType:"application/json",
                  dataType:"json",
                }); 
                $("#light1button").val("On");
                $("#light1icon").removeClass("light-off").addClass("light-on");
            }
            else
            {
                var obj = {light1state: "Off"};
                $.ajax({
                  url:"/postvars",
                  type: "POST",
                  data: JSON.stringify(obj),
                  contentType:"application/json",
                  dataType:"json",
                }); 
                $("#light1button").val("Off");
                $("#light1icon").removeClass("light-on").addClass("light-off");
            }
        });
        /* end code for Light1 */

        /* start code for Light2 */
        /* change to have light2button, light2icon and light2state , all the rest remain unchanged */
        $("#light2button").click(function(){
            var current_state = $("#light2icon").hasClass("light-off");
                
            if(current_state == true)
            {
                var obj = {light2state: "On"};
                $.ajax({
                  url:"/postvars",
                  type: "POST",
                  data: JSON.stringify(obj),
                  contentType:"application/json",
                  dataType:"json",
                }); 
                $("#light2button").val("On");
                $("#light2icon").removeClass("light-off").addClass("light-on");
            }
            else
            {
                var obj = {light2state: "Off"};
                $.ajax({
                  url:"/postvars",
                  type: "POST",
                  data: JSON.stringify(obj),
                  contentType:"application/json",
                  dataType:"json",
                }); 
                $("#light2button").val("Off");
                $("#light2icon").removeClass("light-on").addClass("light-off");
            }
        });
        /* end code for Light2 */

        /* add more Lights here */
        /* start code for LightN */
        /* change to have lightNbutton, lightNicon and lightNstate , all the rest remain unchanged */
        /* end code for LightN */

        /* start code for Motors */
        $(function drivemotors() {
      
          function setsliders(dleftslider, drightslider)
          {
             var motorsobj = {"leftslider": dleftslider, "rightslider": drightslider};
             
                $.ajax({
                  url:"/postvars",
                  type: "POST",
                  data: JSON.stringify(motorsobj),
                  contentType:"application/json",
                  dataType:"json",
                });
             
             //console.log("Sliders: " + JSON.stringify(motorsobj) + " ... to be sent by json object");
          }

          $("#sliders").css("touch-action", "none");
          
          $("#LSlider, #RSlider").on("input", function slidersmove(e) {

             e.preventDefault(); e.stopPropagation();
             
             //$("#sliders").css("touch-action", "none");
             
             dleftslider = $("#LSlider").val();
             $("#LOutput").html(dleftslider);
             drightslider = $("#RSlider").val();
             $("#ROutput").html(drightslider);
             
             setsliders(dleftslider, drightslider);
             
          });
          
          $("#LSlider").on("mouseup touchend", function lsliderelease(e) {
             
             e.preventDefault();
             e.stopPropagation();
             
             dleftslider = "0";
             $("#LSlider").val("0");
             $("#LOutput").html("0");
             drightslider = $("#RSlider").val();
             $("#ROutput").html(drightslider);
            
             setsliders(dleftslider, drightslider);
             
          });
          
          $("#RSlider").on("mouseup touchend", function rsliderelease(e) {
             
             e.preventDefault(); 
             e.stopPropagation();
             
             dleftslider = $("#LSlider").val();
             $("#LOutput").html(dleftslider);
             drightslider = "0";
             $("#RSlider").val("0");
             $("#ROutput").html("0");
             
             setsliders(dleftslider, drightslider);
             
          });
          
          $("#gamepad").on("touchstart touchmove", function(e){ e.preventDefault(); e.stopPropagation(); }); 
          
          $("#drive-N").on("mousedown touchstart touchdown", function(e) {
             
             //e.preventDefault(); 
             e.stopPropagation();
             
             //$("#gamepad").css("touch-action", "none"); 
             //$("#gamepad").on("touchstart", function(e){ e.preventDefault(); e.stopPropagation(); }); 
             
             $("#LSlider").val("256");
             $("#LOutput").html("256");
             $("#RSlider").val("256");
             $("#ROutput").html("256");
             
             setsliders("256", "256");
             
             //return false;
             
          });
          
          $("#drive-NE").on("mousedown touchstart touchdown", function(e) {
             
             e.stopPropagation();
        
             $("#LSlider").val("256");
             $("#LOutput").html("256");
             $("#RSlider").val("128");
             $("#ROutput").html("128");
             
             setsliders("256", "128");
             
          });
          
          $("#drive-E").on("mousedown touchstart touchdown", function(e) {
             
             e.stopPropagation();
             
             $("#LSlider").val("128");
             $("#LOutput").html("128");
             $("#RSlider").val("-128");
             $("#ROutput").html("-128");
             
             setsliders("128", "-128");
    
          });
          
          $("#drive-SE").on("mousedown touchstart touchdown", function(e) {
             
             e.stopPropagation();
             
             $("#LSlider").val("-256");
             $("#LOutput").html("-256");
             $("#RSlider").val("-128");
             $("#ROutput").html("-128");
             
             setsliders("-256", "-128");
             
          });
          
          $("#drive-S").on("mousedown touchstart touchdown", function(e) {
             
             e.stopPropagation();
             
             $("#LSlider").val("-256");
             $("#LOutput").html("-256");
             $("#RSlider").val("-256");
             $("#ROutput").html("-256");
             
             setsliders("-256", "-256");
             
          });
          
          $("#drive-SW").on("mousedown touchstart touchdown", function(e) {
             
             e.stopPropagation();
             
             $("#LSlider").val("-128");
             $("#LOutput").html("-128");
             $("#RSlider").val("-256");
             $("#ROutput").html("-256");
             
             setsliders("-128", "-256");
             
          });
          
          $("#drive-W").on("mousedown touchstart touchdown", function(e) {
             
             e.stopPropagation();
             
             $("#LSlider").val("-128");
             $("#LOutput").html("-128");
             $("#RSlider").val("128");
             $("#ROutput").html("128");
             
             setsliders("-128", "128");
             
          });
          
          $("#drive-NW").on("mousedown touchstart touchdown", function(e) {
             
             e.stopPropagation();
             
             $("#LSlider").val("128");
             $("#LOutput").html("128");
             $("#RSlider").val("256");
             $("#ROutput").html("256");
                   
             setsliders("128", "256");
             
          });
          
          $("#drive-N, #drive-NE, #drive-E, #drive-SE, #drive-S, #drive-SW, #drive-W, #drive-NW").on("mouseup touchend", function(e) {
             
             e.preventDefault(); 
             e.stopPropagation();
             
             $("#LSlider").val("0");
             $("#LOutput").html("0");
             $("#RSlider").val("0");
             $("#ROutput").html("0");
             
             setsliders("0", "0");
    
          });
          //console.log("Sliders: " + dleftslider + " , " + drightslider + " on input...");
        });
        /* end code for Motors */
    
        /* start code for Reset */
        $("#ResetWiFiButton").click(function(){
         var obj = {resetwifistate: "On"};
                $.ajax({
                  url:"/postvars",
                  type: "POST",
                  data: JSON.stringify(obj),
                  contentType:"application/json",
                  dataType:"json",
                });
        }); 
        /* end code for Reset */
    
  });
/* end of JSON with Ajax for POSTvars */

</script>
</html>)rawliteral";

// Replaces placeholder with DHT values
String processor(const String& var){
  //Serial.println(var);
  if(var == F("TEMPERATURE")){
    return String(t);
  }
  else if(var == F("HUMIDITY")){
    return String(h);
  }
  return String();
}

void notFound(AsyncWebServerRequest *request) {
  request->send(404, "text/plain", "Not found");
}

void setup() {
  // put your setup code here, to run once:
  Serial.begin(115200);

  //set led pin as output
  pinMode(BUILTIN_LED, OUTPUT);
  // start ticker with 0.5 because we start in AP mode and try to connect
  ticker.attach(0.6, tick);

  dht.begin();

  //this initialise the pin stored in the variable LED as OUTPUT
  //this intruction lowers the impedance of the pin so it can provide a higher current to other components
  pinMode(Light1, OUTPUT);
  pinMode(Light2, OUTPUT);
  //pinMode(LightN, OUTPUT); // add more Lights here

    //set led pin as output
  pinMode(BUILTIN_LED, OUTPUT);
  // start ticker with 0.5 because we start in AP mode and try to connect
  ticker.attach(0.6, tick);

  //WiFiManager
  //Local intialization. Once its business is done, there is no need to keep it around
  AsyncWiFiManager wifiManager(&server,&dns);
  //reset settings - for testing
  //wifiManager.resetSettings();

  //set callback that gets called when connecting to previous WiFi fails, and enters Access Point mode
  wifiManager.setAPCallback(configModeCallback);

  //fetches ssid and pass and tries to connect
  //and goes into a blocking loop awaiting configuration
  if (!wifiManager.autoConnect("DsA-Tiny-RC")) {
    Serial.println("failed to connect and hit timeout");
    //reset and try again
    ESP.reset();
    delay(1000);
  }

  //if you get here you have connected to the WiFi
  Serial.println("connected...yeey :)");
  ticker.detach();
  //keep LED on
  digitalWrite(BUILTIN_LED, LOW);

  // Route for root / web page
  server.on("/", HTTP_GET, [](AsyncWebServerRequest *request){
    request->send_P(200, "text/html", index_html, processor);
  });
  
  server.on("/temperature", HTTP_GET, [](AsyncWebServerRequest *request){
    request->send_P(200, "text/plain", String(t).c_str());
  });
  
  server.on("/humidity", HTTP_GET, [](AsyncWebServerRequest *request){
    request->send_P(200, "text/plain", String(h).c_str());
  });

 // start of code for getting Json POST requests to <IP>/postvars (turn on/off lights, reset, other data from buttons)
 AsyncCallbackJsonWebHandler* postvarsHandler = new AsyncCallbackJsonWebHandler("/postvars", 
    [](AsyncWebServerRequest *request, JsonVariant &postedvars) {
    if(!postedvars.is<JsonObject>()) {
      Serial.println("[/postvars 400] invalid JSON postedvars");
      request->send(400, "application/json", "{\"error\": \"invalid request, please send JSON postedvars\"}");
      return;
    }

    // Get commands for Lights (light1button, light1state; light2button, light2state; ...)
    
    // start of code for Light1 
    if(!postedvars["light1state"].isNull()) {
      String light1state = postedvars["light1state"].as<char*>();
      (light1state == "On")? digitalWrite(Light1, HIGH) : digitalWrite(Light1, LOW);
      Serial.println("light1state is " + light1state + " ... Hooray");  // comment when release
      request->send(201, "text/plain", "OK, light1state is now " + light1state + " ... Hooray");
    } // end of code for Light1

    // start of code for Light2 
    if(!postedvars["light2state"].isNull()) {
      String light2state = postedvars["light2state"].as<char*>();
      (light2state == "On")? digitalWrite(Light2, HIGH) : digitalWrite(Light2, LOW);
      Serial.println("light2state is " + light2state + " ... Hooray");  // comment when release
      request->send(201, "text/plain", "OK, light2state is now " + light2state + " ... Hooray");
    } // end of code for Light2

    // insert here code for LightN and so on..
    // ...
    // end here code for LightN and so on...

    // start of code for motors (sliders) 
    if(!postedvars["leftslider"].isNull() && !postedvars["rightslider"].isNull()) {
      String leftslider = postedvars["leftslider"].as<char*>();
      String rightslider = postedvars["rightslider"].as<char*>();
      String leftrotation = "stop";
      String rightrotation = "stop";
      (leftslider == "0")? leftrotation = "stop" : (leftslider > "0")? leftrotation = "clockwise" : leftrotation = "counterclockwise";
      //(leftslider > "0")? leftrotation = "clockwise" : leftrotation = "counterclockwise";
      (rightslider == "0")? rightrotation = "stop" : (rightslider > "0")? rightrotation = "clockwise" : rightrotation = "counterclockwise";
      //(rightslider > "0")? rightrotation = "clockwise" : rightrotation = "counterclockwise";
      
      //(leftslider == 0)? leftrotation = "stop" : ((leftslider > 0)? leftrotation = "clockwise" : ((leftslider < 0)? leftrotation = "counterclockwise" : leftrotation = "stop"));
      //(rightslider == 0)? rightrotation = "stop" : ((rightslider > 0)? rightrotation = "clockwise" : ((rightslider < 0)? rightrotation = "counterclockwise" : rightrotation = "stop"));
      
      // actions for motors by sliders
      // motors code here
      Serial.println("Motors \n left rotation: " + leftrotation + " , speed: " + leftslider + " || right rotation: " + rightrotation + " , speed: " + rightslider + " ... Hooray");  // comment when release
      request->send(201, "text/plain", "Motors \n left rotation: " + leftrotation + " , speed: " + leftslider + " || right rotation: " + rightrotation + " , speed: " + rightslider + " ... Hooray");
    } // end of code for motors (sliders)
    
    // start of code for ResetWiFiButton 
    if(!postedvars["resetwifistate"].isNull()) {
      resetwifi = postedvars["resetwifistate"].as<char*>();
      (resetwifi == "On")? "" : resetwifi = "Off";
      //Serial.println("resetwifistate is " + resetwifi + " ... Hooray");  // comment when release
      request->send(201, "text/plain", "OK, resetwifistate is now " + resetwifi + " ... Hooray");
    } // end of code for ResetWiFiButton
    
  });
  server.addHandler(postvarsHandler);
  // end of code for getting Json POST requests

  server.onNotFound(notFound);

  // Start server
  server.begin();

  //print in Serial Monitor that the HTTP server is started
  //Serial.println("HTTP server started");
  Serial.print("local ip: ");
  Serial.println(WiFi.localIP());

  //Serial.print("void setup, reset state: ");
  //Serial.println(resetwifi);
  
} // end void setup

void loop() {
  // insert code here to run repeatedly

  // start WiFiManager
  if ( resetwifi == "On" ) {
    
    resetwifi = "Off";
    
    //Local intialization. Once its business is done, there is no need to keep it around
    AsyncWiFiManager wifiManager(&server,&dns);
    
    //reset settings - for testing
    wifiManager.resetSettings();
    
    //sets timeout until configuration portal gets turned off
    //useful to make it all retry or go to sleep
    //in seconds
    //wifiManager.setTimeout(120);
    
    //set callback that gets called when connecting to previous WiFi fails, and enters Access Point mode
    //wifiManager.setAPCallback(configModeCallback);

    //WITHOUT THIS THE AP DOES NOT SEEM TO WORK PROPERLY WITH SDK 1.5 , update to at least 1.5.1
    //WiFi.mode(WIFI_STA);
    
    //fetches ssid and pass and tries to connect
    //if it does not connect it starts an access point with the specified name
    //and goes into a blocking loop awaiting configuration
    //if (!wifiManager.startConfigPortal("DsA-Tiny-RC", "p4ssw0rd")) {
    /*
    if (!wifiManager.startConfigPortal("DsA-Tiny-RC")) {
      Serial.println("failed to connect and hit timeout");
      delay(1000);
      //reset and try again, or maybe put it to deep sleep
      ESP.reset();
      delay(1000);
    }
    */
    ESP.reset();
    delay(1000);
      
    //if you get here you have connected to the WiFi
    //Serial.println("connected! ...yeey! :-)");
    /*
    ticker.detach();
    //keep LED on
    digitalWrite(BUILTIN_LED, LOW);
    */
    //Serial.print("local ip: ");
    //Serial.println(WiFi.localIP());
    
    // Start server
    //server.begin();
    
    //print in Serial Monitor that the HTTP server is started
    //Serial.println("HTTP server started");
    
  } // end reset WiFiManager
  
  unsigned long currentMillis = millis();
  if (currentMillis - previousMillis >= interval) {
    // save the last time you updated the DHT values
    previousMillis = currentMillis;
    
    // Read Temperature
    float newT = dht.readTemperature(); // Read temperature as Celsius (the default)   
    //float newT = dht.readTemperature(true); // Read temperature as Fahrenheit (isFahrenheit = true)
    
    // if temperature read failed, change t value to 0.00
    if (isnan(newT)) {
      t = 0.00;
      Serial.println("Failed to read temperature from DHT sensor!");
    }
    else {
      t = newT;
      Serial.print("temperature: ");
      Serial.println(t);
    }
    
    // Read Humidity
    float newH = dht.readHumidity();
    
    // if humidity read failed, change h value to 0.00
    if (isnan(newH)) {
      h = 0.00;
      Serial.println("Failed to read humidity from DHT sensor!");
    }
    else {
      h = newH;
      Serial.print("humidity: ");
      Serial.println(h);
    }

    // insert if test for resetwifi string, then print it...
    //Serial.print("void loop reset state: ");
    //Serial.println(resetwifi);
  }
  
} // end void loop
